## buildroot-external/package/alsa-ucm-conf/Config.in
```kconfig
config BR2_PACKAGE_ALSA_UCM_CONF
	bool "alsa-ucm-conf"
	depends on BR2_PACKAGE_ALSA_LIB_UCM
        help
	  ALSA Use Case Manager configuration.
```

## buildroot-external/package/armnn/Config.in
```kconfig
config BR2_PACKAGE_ARMNN
	select BR2_PACKAGE_COMPUTE_LIBRARY
	select BR2_PACKAGE_TENSORFLOW_LITE
	bool "armnn"
	help
	  Arm NN is the most performant machine learning (ML) 
	  inference engine for Android and Linux, accelerating 
	  ML on Arm Cortex-A CPUs and Arm Mali GPUs. 

	  https://github.com/ARM-software/armnn
```

## buildroot-external/package/baresip/Config.in
```kconfig
config BR2_PACKAGE_BARESIP
	bool "baresip"
	help
	  Modular SIP Useragent.

	  http://www.creytiv.com/
```

## buildroot-external/package/btspeaker/Config.in
```kconfig
config BR2_PACKAGE_BTSPEAKER
	bool "btspeaker"
	help
	  Service to start a BT Speaker daemon.

	  https://www.j1nx.nl
```

## buildroot-external/package/ck/Config.in
```kconfig
config BR2_PACKAGE_CK_ARCH_SUPPORTS
	bool
	default y if BR2_arm && !BR2_ARM_CPU_ARMV4 && !BR2_ARM_CPU_ARMV5 && !BR2_ARM_CPU_ARMV7M
	default y if BR2_aarch64
	default y if BR2_powerpc || BR2_powerpc64 || BR2_powerpc64le
	default y if BR2_s390x
	default y if BR2_sparc_v9
	default y if BR2_i386
	default y if BR2_x86_64

config BR2_PACKAGE_CK
	bool "concurrency kit"
	depends on BR2_PACKAGE_CK_ARCH_SUPPORTS
	help
	  Concurrency primitives, safe memory reclamation mechanisms
	  and non-blocking data structures for the research, design and
	  implementation of high performance concurrent systems.

	  https://github.com/concurrencykit/ck.git
```

## buildroot-external/package/clog/Config.in
```kconfig
config BR2_PACKAGE_CLOG
	bool "clog"
	help
	  C-style library for logging errors, warnings,
	  information notes, and debug information.

	  https://github.com/pytorch/cpuinfo/tree/master/deps/clog
```

## buildroot-external/package/compute-library/Config.in
```kconfig
config BR2_PACKAGE_COMPUTE_LIBRARY
	bool "compute-library"
	help
	  The Compute Library is a set of computer vision and 
	  machine learning functions optimised for both Arm CPUs 
	  and GPUs using SIMD technologies.

	  https://github.com/ARM-software/ComputeLibrary
```

## buildroot-external/package/cpuinfo/Config.in
```kconfig
config BR2_PACKAGE_CPUINFO
	bool "cpuinfo"
	depends on BR2_INSTALL_LIBSTDCPP
	help
	  cpuinfo is a library to detect essential for performance
	  optimization information about host CPU.

	  https://github.com/pytorch/cpuinfo
```

## buildroot-external/package/deepfilternet-ladspa/Config.in
```kconfig
config BR2_PACKAGE_DEEPFILTERNET_LADSPA
	bool "deepfilternet-ladspa"
	depends on BR2_PACKAGE_HOST_RUSTC_TARGET_ARCH_SUPPORTS
	select BR2_PACKAGE_HOST_CARGO
	select BR2_PACKAGE_HDF5 
        help
	  DeepFilterNet LADSPA Plugin

	  https://github.com/Rikorose/DeepFilterNet
```

## buildroot-external/package/docbook-xml/Config.in
```kconfig
config BR2_PACKAGE_DOCBOOK_XML
	bool "docbook-xml"
	help
	  Document type definitions for verification 
	  of XML data files against the DocBook rule set, 
	  it ships with the latest DocBook 4.5 XML DTD, 
	  as well as a selected set of legacy DTDs for 
	  use with older documents, including 4.0, 4.1.2, 
	  4.2, 4.3 and 4.4

	  http://www.docbook.org/xml/
```

## buildroot-external/package/docbook-xsl/Config.in
```kconfig
config BR2_PACKAGE_DOCBOOK_XSL
	bool "docbook-xsl"
	help
	  XSL stylesheets for processing DocBook XML 
	  to various output formats

	  http://docbook.sourceforge.net
```

## buildroot-external/package/fann/Config.in
```kconfig
config BR2_PACKAGE_FANN
	bool "fann"
	help
	  Fast Artificial Neural Network (FANN) Library 
	  is a free open source neural network library, 
	  which implements multilayer artificial neural 
	  networks in C with support for both fully 
	  connected and sparsely connected networks.

	  https://github.com/libfann/fann
```

## buildroot-external/package/farmhash/Config.in
```kconfig
config BR2_PACKAGE_FARMHASH
	bool "farmhash"
	depends on BR2_INSTALL_LIBSTDCPP
	help
	  FarmHash, a family of hash functions.

	  https://github.com/google/farmhash
```

## buildroot-external/package/firstboot-service/Config.in
```kconfig
config BR2_PACKAGE_FIRSTBOOT_SERVICE
	bool "firstboot-service"
	help
	  A systemd service that only runs on first boot
	  which can be used to run certain scripts that
	  prepare the rootfs. For now being used to auto
	  expand the filesystem over the full size of the
	  SD card.
```

## buildroot-external/package/gemmlowp/Config.in
```kconfig
config BR2_PACKAGE_GEMMLOWP
	bool "gemmlowp"
	depends on BR2_INSTALL_LIBSTDCPP
	help
	  Low-precision matrix multiplication.

	  https://github.com/google/gemmlowp
```

## buildroot-external/package/growdisk-service/Config.in
```kconfig
config BR2_PACKAGE_GROWDISK_SERVICE
	bool "growdisk-service"
	help
	  A systemd service that only runs on file flag
	  to auto expand the filesystem over the full size 
	  of the used disk.
```

## buildroot-external/package/hdf5-hosttools/Config.in
```kconfig
config BR2_PACKAGE_HDF5_HOSTTOOLS
	bool "hdf5-hosttools"
	help
	  high-performance library's source code and a 
	  file format specification that implement the 
	  HDF5® data model.

	  https://github.com/HDFGroup/hdf5
```

## buildroot-external/package/hdf5/Config.in
```kconfig
config BR2_PACKAGE_HDF5
	bool "hdf5"
	help
	  high-performance library's source code and a 
	  file format specification that implement the 
	  HDF5® data model.

	  https://github.com/HDFGroup/hdf5
```

## buildroot-external/package/hostname-service/Config.in
```kconfig
config BR2_PACKAGE_HOSTNAME_SERVICE
	bool "hostname-service"
	help
	  A systemd service that adds the last bits
	  of the MAC address to the hostname.
```

## buildroot-external/package/kaldi/Config.in
```kconfig
config BR2_PACKAGE_KALDI
	bool "kaldi"
	select BR2_PACKAGE_LAPACK
	select BR2_PACKAGE_OPENFST
	help
	  Kaldi Speech Recognition Toolkit

	  https://github.com/kaldi-asr/kaldi
```
