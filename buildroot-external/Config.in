## buildroot-external/Config.in
```kconfig
menu "Additional drivers, libraries and/or applications"
	source "$BR2_EXTERNAL_OPENVOICEOS_PATH/package/baresip/Config.in"
	source "$BR2_EXTERNAL_OPENVOICEOS_PATH/package/btspeaker/Config.in"
	source "$BR2_EXTERNAL_OPENVOICEOS_PATH/package/clog/Config.in"
	source "$BR2_EXTERNAL_OPENVOICEOS_PATH/package/cpuinfo/Config.in"
	source "$BR2_EXTERNAL_OPENVOICEOS_PATH/package/deepfilternet-ladspa/Config.in"
	source "$BR2_EXTERNAL_OPENVOICEOS_PATH/package/docbook-xml/Config.in"
	source "$BR2_EXTERNAL_OPENVOICEOS_PATH/package/docbook-xsl/Config.in"
	source "$BR2_EXTERNAL_OPENVOICEOS_PATH/package/fann/Config.in"
	source "$BR2_EXTERNAL_OPENVOICEOS_PATH/package/farmhash/Config.in"
	source "$BR2_EXTERNAL_OPENVOICEOS_PATH/package/fft2d/Config.in"
	source "$BR2_EXTERNAL_OPENVOICEOS_PATH/package/fp16/Config.in"
	source "$BR2_EXTERNAL_OPENVOICEOS_PATH/package/fxdiv/Config.in"
	source "$BR2_EXTERNAL_OPENVOICEOS_PATH/package/gemmlowp/Config.in"
	source "$BR2_EXTERNAL_OPENVOICEOS_PATH/package/growdisk-service/Config.in"
	source "$BR2_EXTERNAL_OPENVOICEOS_PATH/package/hdf5/Config.in"
	source "$BR2_EXTERNAL_OPENVOICEOS_PATH/package/hostname-service/Config.in"
	source "$BR2_EXTERNAL_OPENVOICEOS_PATH/package/kaldi/Config.in"
menu "KDE Framework and Plasma"
	source "$BR2_EXTERNAL_OPENVOICEOS_PATH/package/kf5-attica/Config.in"
	source "$BR2_EXTERNAL_OPENVOICEOS_PATH/package/kf5-breeze-icons/Config.in"
	source "$BR2_EXTERNAL_OPENVOICEOS_PATH/package/kf5-kactivities/Config.in"
	source "$BR2_EXTERNAL_OPENVOICEOS_PATH/package/kf5-kactivities-stats/Config.in"
	source "$BR2_EXTERNAL_OPENVOICEOS_PATH/package/kf5-karchive/Config.in"
	source "$BR2_EXTERNAL_OPENVOICEOS_PATH/package/kf5-kauth/Config.in"
	source "$BR2_EXTERNAL_OPENVOICEOS_PATH/package/kf5-kbookmarks/Config.in"
	source "$BR2_EXTERNAL_OPENVOICEOS_PATH/package/kf5-kcmutils/Config.in"
	source "$BR2_EXTERNAL_OPENVOICEOS_PATH/package/kf5-kcodecs/Config.in"
	source "$BR2_EXTERNAL_OPENVOICEOS_PATH/package/kf5-kcompletion/Config.in"
	source "$BR2_EXTERNAL_OPENVOICEOS_PATH/package/kf5-kconfig/Config.in"
	source "$BR2_EXTERNAL_OPENVOICEOS_PATH/package/kf5-kconfigwidgets/Config.in"
	source "$BR2_EXTERNAL_OPENVOICEOS_PATH/package/kf5-kcrash/Config.in"
	source "$BR2_EXTERNAL_OPENVOICEOS_PATH/package/kf5-kdbusaddons/Config.in"
	source "$BR2_EXTERNAL_OPENVOICEOS_PATH/package/kf5-kdeclarative/Config.in"
	source "$BR2_EXTERNAL_OPENVOICEOS_PATH/package/kf5-kdeconnect/Config.in"
	source "$BR2_EXTERNAL_OPENVOICEOS_PATH/package/kf5-kdecoration/Config.in"
	source "$BR2_EXTERNAL_OPENVOICEOS_PATH/package/kf5-kded/Config.in"
	source "$BR2_EXTERNAL_OPENVOICEOS_PATH/package/kf5-kdelibs4support/Config.in"
	source "$BR2_EXTERNAL_OPENVOICEOS_PATH/package/kf5-kdesignerplugin/Config.in"
	source "$BR2_EXTERNAL_OPENVOICEOS_PATH/package/kf5-kdesu/Config.in"
	source "$BR2_EXTERNAL_OPENVOICEOS_PATH/package/kf5-kdoctools/Config.in"
	source "$BR2_EXTERNAL_OPENVOICEOS_PATH/package/kf5-kemoticons/Config.in"
	source "$BR2_EXTERNAL_OPENVOICEOS_PATH/package/kf5-kglobalaccel/Config.in"
	source "$BR2_EXTERNAL_OPENVOICEOS_PATH/package/kf5-kguiaddons/Config.in"
	source "$BR2_EXTERNAL_OPENVOICEOS_PATH/package/kf5-ki18n/Config.in"
	source "$BR2_EXTERNAL_OPENVOICEOS_PATH/package/kf5-kiconthemes/Config.in"
	source "$BR2_EXTERNAL_OPENVOICEOS_PATH/package/kf5-kidletime/Config.in"
	source "$BR2_EXTERNAL_OPENVOICEOS_PATH/package/kf5-kinit/Config.in"
	source "$BR2_EXTERNAL_OPENVOICEOS_PATH/package/kf5-kio/Config.in"
	source "$BR2_EXTERNAL_OPENVOICEOS_PATH/package/kf5-kirigami2/Config.in"
	source "$BR2_EXTERNAL_OPENVOICEOS_PATH/package/kf5-kitemmodels/Config.in"
	source "$BR2_EXTERNAL_OPENVOICEOS_PATH/package/kf5-kitemviews/Config.in"
	source "$BR2_EXTERNAL_OPENVOICEOS_PATH/package/kf5-kjobwidgets/Config.in"
	source "$BR2_EXTERNAL_OPENVOICEOS_PATH/package/kf5-knewstuff/Config.in"
	source "$BR2_EXTERNAL_OPENVOICEOS_PATH/package/kf5-knotifications/Config.in"
	source "$BR2_EXTERNAL_OPENVOICEOS_PATH/package/kf5-knotifyconfig/Config.in"
	source "$BR2_EXTERNAL_OPENVOICEOS_PATH/package/kf5-kpackage/Config.in"
	source "$BR2_EXTERNAL_OPENVOICEOS_PATH/package/kf5-kparts/Config.in"
	source "$BR2_EXTERNAL_OPENVOICEOS_PATH/package/kf5-kpeople/Config.in"
	source "$BR2_EXTERNAL_OPENVOICEOS_PATH/package/kf5-kpty/Config.in"
	source "$BR2_EXTERNAL_OPENVOICEOS_PATH/package/kf5-krunner/Config.in"
	source "$BR2_EXTERNAL_OPENVOICEOS_PATH/package/kf5-kscreen/Config.in"
	source "$BR2_EXTERNAL_OPENVOICEOS_PATH/package/kf5-kscreenlocker/Config.in"
	source "$BR2_EXTERNAL_OPENVOICEOS_PATH/package/kf5-kservice/Config.in"
	source "$BR2_EXTERNAL_OPENVOICEOS_PATH/package/kf5-ksysguard/Config.in"
	source "$BR2_EXTERNAL_OPENVOICEOS_PATH/package/kf5-ktextwidgets/Config.in"
	source "$BR2_EXTERNAL_OPENVOICEOS_PATH/package/kf5-kunitconversion/Config.in"
	source "$BR2_EXTERNAL_OPENVOICEOS_PATH/package/kf5-kwayland/Config.in"
	source "$BR2_EXTERNAL_OPENVOICEOS_PATH/package/kf5-kwayland-server/Config.in"
	source "$BR2_EXTERNAL_OPENVOICEOS_PATH/package/kf5-kwallet/Config.in"
	source "$BR2_EXTERNAL_OPENVOICEOS_PATH/package/kf5-kwidgetsaddons/Config.in"
	source "$BR2_EXTERNAL_OPENVOICEOS_PATH/package/kf5-kwin/Config.in"
	source "$BR2_EXTERNAL_OPENVOICEOS_PATH/package/kf5-kwindowsystem/Config.in"
	source "$BR2_EXTERNAL_OPENVOICEOS_PATH/package/kf5-kxmlgui/Config.in"
	source "$BR2_EXTERNAL_OPENVOICEOS_PATH/package/kf5-layer-shell-qt/Config.in"
	source "$BR2_EXTERNAL_OPENVOICEOS_PATH/package/kf5-libkscreen/Config.in"
	source "$BR2_EXTERNAL_OPENVOICEOS_PATH/package/kf5-libksysguard/Config.in"
	source "$BR2_EXTERNAL_OPENVOICEOS_PATH/package/kf5-phonon/Config.in"
	source "$BR2_EXTERNAL_OPENVOICEOS_PATH/package/kf5-plasma-framework/Config.in"
	source "$BR2_EXTERNAL_OPENVOICEOS_PATH/package/kf5-plasma-nano/Config.in"
	source "$BR2_EXTERNAL_OPENVOICEOS_PATH/package/kf5-plasma-nm/Config.in"
	source "$BR2_EXTERNAL_OPENVOICEOS_PATH/package/kf5-plasma-pa/Config.in"
	source "$BR2_EXTERNAL_OPENVOICEOS_PATH/package/kf5-plasma-wayland-protocols/Config.in"
	source "$BR2_EXTERNAL_OPENVOICEOS_PATH/package/kf5-plasma-workspace/Config.in"
	source "$BR2_EXTERNAL_OPENVOICEOS_PATH/package/kf5-prison/Config.in"
	source "$BR2_EXTERNAL_OPENVOICEOS_PATH/package/kf5-pulseaudio-qt/Config.in"
	source "$BR2_EXTERNAL_OPENVOICEOS_PATH/package/kf5-qca/Config.in"
	source "$BR2_EXTERNAL_OPENVOICEOS_PATH/package/kf5-qqc2-breeze-style/Config.in"
	source "$BR2_EXTERNAL_OPENVOICEOS_PATH/package/kf5-qqc2-desktop-style/Config.in"
	source "$BR2_EXTERNAL_OPENVOICEOS_PATH/package/kf5-solid/Config.in"
	source "$BR2_EXTERNAL_OPENVOICEOS_PATH/package/kf5-sonnet/Config.in"
	source "$BR2_EXTERNAL_OPENVOICEOS_PATH/package/kf5-threadweaver/Config.in"
endmenu
	source "$BR2_EXTERNAL_OPENVOICEOS_PATH/package/ksm-preload/Config.in"
	source "$BR2_EXTERNAL_OPENVOICEOS_PATH/package/libcanberra/Config.in"
	source "$BR2_EXTERNAL_OPENVOICEOS_PATH/package/libre/Config.in"
	source "$BR2_EXTERNAL_OPENVOICEOS_PATH/package/librem/Config.in"
	source "$BR2_EXTERNAL_OPENVOICEOS_PATH/package/lottie-qml/Config.in"
	source "$BR2_EXTERNAL_OPENVOICEOS_PATH/package/ncpamixer/Config.in"
	source "$BR2_EXTERNAL_OPENVOICEOS_PATH/package/neon2sse/Config.in"
	source "$BR2_EXTERNAL_OPENVOICEOS_PATH/package/openfst/Config.in"
	source "$BR2_EXTERNAL_OPENVOICEOS_PATH/package/ovos-bus-server/Config.in"
	source "$BR2_EXTERNAL_OPENVOICEOS_PATH/package/ovos-dashboard/Config.in"
	source "$BR2_EXTERNAL_OPENVOICEOS_PATH/package/ovos-shell/Config.in"
	source "$BR2_EXTERNAL_OPENVOICEOS_PATH/package/ovos-splash/Config.in"
	source "$BR2_EXTERNAL_OPENVOICEOS_PATH/package/picotts/Config.in"
	source "$BR2_EXTERNAL_OPENVOICEOS_PATH/package/psimd/Config.in"
	source "$BR2_EXTERNAL_OPENVOICEOS_PATH/package/pthreadpool/Config.in"
	source "$BR2_EXTERNAL_OPENVOICEOS_PATH/package/qt5ct/Config.in"
	source "$BR2_EXTERNAL_OPENVOICEOS_PATH/package/respeaker/Config.in"
	source "$BR2_EXTERNAL_OPENVOICEOS_PATH/package/rnnnoise-ladspa/Config.in"
	source "$BR2_EXTERNAL_OPENVOICEOS_PATH/package/rpi-eeprom/Config.in"
	source "$BR2_EXTERNAL_OPENVOICEOS_PATH/package/ruy/Config.in"
	source "$BR2_EXTERNAL_OPENVOICEOS_PATH/package/snapcast/Config.in"
	source "$BR2_EXTERNAL_OPENVOICEOS_PATH/package/spotifyd/Config.in"
	source "$BR2_EXTERNAL_OPENVOICEOS_PATH/package/tensorflow-lite/Config.in"
	source "$BR2_EXTERNAL_OPENVOICEOS_PATH/package/userland-tools/Config.in"
	source "$BR2_EXTERNAL_OPENVOICEOS_PATH/package/virtual-touch/Config.in"
	source "$BR2_EXTERNAL_OPENVOICEOS_PATH/package/vocalfusion/Config.in"
	source "$BR2_EXTERNAL_OPENVOICEOS_PATH/package/vosk-api/Config.in"
	source "$BR2_EXTERNAL_OPENVOICEOS_PATH/package/whisper-tflite/Config.in"
	source "$BR2_EXTERNAL_OPENVOICEOS_PATH/package/whispercpp/Config.in"
	source "$BR2_EXTERNAL_OPENVOICEOS_PATH/package/wifi-connect/Config.in"
	source "$BR2_EXTERNAL_OPENVOICEOS_PATH/package/wiringpi2/Config.in"
	source "$BR2_EXTERNAL_OPENVOICEOS_PATH/package/xnnpack/Config.in"
	source "$BR2_EXTERNAL_OPENVOICEOS_PATH/package/xorgproto-mesafix/Config.in"
	source "$BR2_EXTERNAL_OPENVOICEOS_PATH/package/xvf3510/Config.in"
endmenu
menu "Additional external python modules"
	source "$BR2_EXTERNAL_OPENVOICEOS_PATH/package/python-adafruit-blinka/Config.in"
	source "$BR2_EXTERNAL_OPENVOICEOS_PATH/package/python-adafruit-circuitpython-neopixel/Config.in"
	source "$BR2_EXTERNAL_OPENVOICEOS_PATH/package/python-adafruit-platformdetect/Config.in"
	source "$BR2_EXTERNAL_OPENVOICEOS_PATH/package/python-adafruit-pureio/Config.in"
	source "$BR2_EXTERNAL_OPENVOICEOS_PATH/package/python-adapt-parser/Config.in"
	source "$BR2_EXTERNAL_OPENVOICEOS_PATH/package/python-appdirs/Config.in"
	source "$BR2_EXTERNAL_OPENVOICEOS_PATH/package/python-astral/Config.in"
	source "$BR2_EXTERNAL_OPENVOICEOS_PATH/package/python-audio-metadata/Config.in"
	source "$BR2_EXTERNAL_OPENVOICEOS_PATH/package/python-beniget/Config.in"
	source "$BR2_EXTERNAL_OPENVOICEOS_PATH/package/python-bitstruct/Config.in"
	source "$BR2_EXTERNAL_OPENVOICEOS_PATH/package/python-blinker/Config.in"
	source "$BR2_EXTERNAL_OPENVOICEOS_PATH/package/python-board/Config.in"
	source "$BR2_EXTERNAL_OPENVOICEOS_PATH/package/python-bs4/Config.in"
	source "$BR2_EXTERNAL_OPENVOICEOS_PATH/package/python-cachetools/Config.in"
	source "$BR2_EXTERNAL_OPENVOICEOS_PATH/package/python-casttube/Config.in"
	source "$BR2_EXTERNAL_OPENVOICEOS_PATH/package/python-click-default-group/Config.in"
	source "$BR2_EXTERNAL_OPENVOICEOS_PATH/package/python-colour/Config.in"
	source "$BR2_EXTERNAL_OPENVOICEOS_PATH/package/python-combo-lock/Config.in"
	source "$BR2_EXTERNAL_OPENVOICEOS_PATH/package/python-convertdate/Config.in"
	source "$BR2_EXTERNAL_OPENVOICEOS_PATH/package/python-coverage/Config.in"
	source "$BR2_EXTERNAL_OPENVOICEOS_PATH/package/python-coveralls/Config.in"
	source "$BR2_EXTERNAL_OPENVOICEOS_PATH/package/python-cutecharts/Config.in"
	source "$BR2_EXTERNAL_OPENVOICEOS_PATH/package/python-dataclasses/Config.in"
	source "$BR2_EXTERNAL_OPENVOICEOS_PATH/package/python-deprecated/Config.in"
	source "$BR2_EXTERNAL_OPENVOICEOS_PATH/package/python-fann2/Config.in"
	source "$BR2_EXTERNAL_OPENVOICEOS_PATH/package/python-fasteners/Config.in"
	source "$BR2_EXTERNAL_OPENVOICEOS_PATH/package/python-feedparser/Config.in"
	source "$BR2_EXTERNAL_OPENVOICEOS_PATH/package/python-flask-fontawesome/Config.in"
	source "$BR2_EXTERNAL_OPENVOICEOS_PATH/package/python-flask-mail/Config.in"
	source "$BR2_EXTERNAL_OPENVOICEOS_PATH/package/python-flask-simplelogin/Config.in"
	source "$BR2_EXTERNAL_OPENVOICEOS_PATH/package/python-flask-socketio/Config.in"
	source "$BR2_EXTERNAL_OPENVOICEOS_PATH/package/python-gast/Config.in"
	source "$BR2_EXTERNAL_OPENVOICEOS_PATH/package/python-geocoder/Config.in"
	source "$BR2_EXTERNAL_OPENVOICEOS_PATH/package/python-geoip-geolite2/Config.in"
	source "$BR2_EXTERNAL_OPENVOICEOS_PATH/package/python-geoip/Config.in"
	source "$BR2_EXTERNAL_OPENVOICEOS_PATH/package/python-gitdb/Config.in"
	source "$BR2_EXTERNAL_OPENVOICEOS_PATH/package/python-gitpython/Config.in"
	source "$BR2_EXTERNAL_OPENVOICEOS_PATH/package/python-google-api-python-client/Config.in"
	source "$BR2_EXTERNAL_OPENVOICEOS_PATH/package/python-google-auth-httplib2/Config.in"
	source "$BR2_EXTERNAL_OPENVOICEOS_PATH/package/python-google-auth/Config.in"
	source "$BR2_EXTERNAL_OPENVOICEOS_PATH/package/python-google-trans-new/Config.in"
	source "$BR2_EXTERNAL_OPENVOICEOS_PATH/package/python-gpsdclient/Config.in"
	source "$BR2_EXTERNAL_OPENVOICEOS_PATH/package/python-gtts/Config.in"
	source "$BR2_EXTERNAL_OPENVOICEOS_PATH/package/python-gtts_token/Config.in"
	source "$BR2_EXTERNAL_OPENVOICEOS_PATH/package/python-hijri-converter/Config.in"
	source "$BR2_EXTERNAL_OPENVOICEOS_PATH/package/python-holidays/Config.in"
	source "$BR2_EXTERNAL_OPENVOICEOS_PATH/package/python-humanhash3/Config.in"
	source "$BR2_EXTERNAL_OPENVOICEOS_PATH/package/python-inflect/Config.in"
	source "$BR2_EXTERNAL_OPENVOICEOS_PATH/package/python-json-database/Config.in"
	source "$BR2_EXTERNAL_OPENVOICEOS_PATH/package/python-kthread/Config.in"
	source "$BR2_EXTERNAL_OPENVOICEOS_PATH/package/python-korean-lunar-calendar/Config.in"
	source "$BR2_EXTERNAL_OPENVOICEOS_PATH/package/python-langcodes/Config.in"
	source "$BR2_EXTERNAL_OPENVOICEOS_PATH/package/python-lazy/Config.in"
	source "$BR2_EXTERNAL_OPENVOICEOS_PATH/package/python-levenshtein/Config.in"
	source "$BR2_EXTERNAL_OPENVOICEOS_PATH/package/python-lingua-nostra/Config.in"
	source "$BR2_EXTERNAL_OPENVOICEOS_PATH/package/python-memory-tempfile/Config.in"
	source "$BR2_EXTERNAL_OPENVOICEOS_PATH/package/python-mock-msm/Config.in"
	source "$BR2_EXTERNAL_OPENVOICEOS_PATH/package/python-monotonic/Config.in"
	source "$BR2_EXTERNAL_OPENVOICEOS_PATH/package/python-msk/Config.in"
	source "$BR2_EXTERNAL_OPENVOICEOS_PATH/package/python-msm/Config.in"
	source "$BR2_EXTERNAL_OPENVOICEOS_PATH/package/python-multi-key-dict/Config.in"
	source "$BR2_EXTERNAL_OPENVOICEOS_PATH/package/python-mycroft-messagebus-client/Config.in"
	source "$BR2_EXTERNAL_OPENVOICEOS_PATH/package/python-neon-lang-plugin-libretranslate/Config.in"
	source "$BR2_EXTERNAL_OPENVOICEOS_PATH/package/python-neon-phal-plugin-fan/Config.in"
	source "$BR2_EXTERNAL_OPENVOICEOS_PATH/package/python-neon-phal-plugin-linear-led/Config.in"
	source "$BR2_EXTERNAL_OPENVOICEOS_PATH/package/python-neon-phal-plugin-switches/Config.in"
	source "$BR2_EXTERNAL_OPENVOICEOS_PATH/package/python-neon-solver-plugin-ddg/Config.in"
	source "$BR2_EXTERNAL_OPENVOICEOS_PATH/package/python-neon-solver-plugin-wikipedia/Config.in"
	source "$BR2_EXTERNAL_OPENVOICEOS_PATH/package/python-neon-solver-plugin-wolfram-alpha/Config.in"
	source "$BR2_EXTERNAL_OPENVOICEOS_PATH/package/python-neon-solvers/Config.in"
	source "$BR2_EXTERNAL_OPENVOICEOS_PATH/package/python-neon-transformers/Config.in"
	source "$BR2_EXTERNAL_OPENVOICEOS_PATH/package/python-neon-utterance-plugin-rake/Config.in"
	source "$BR2_EXTERNAL_OPENVOICEOS_PATH/package/python-num2words/Config.in"
	source "$BR2_EXTERNAL_OPENVOICEOS_PATH/package/python-oauth2client/Config.in"
	source "$BR2_EXTERNAL_OPENVOICEOS_PATH/package/python-olefile/Config.in"
	source "$BR2_EXTERNAL_OPENVOICEOS_PATH/package/python-padacioso/Config.in"
	source "$BR2_EXTERNAL_OPENVOICEOS_PATH/package/python-padaos/Config.in"
	source "$BR2_EXTERNAL_OPENVOICEOS_PATH/package/python-padatious/Config.in"
	source "$BR2_EXTERNAL_OPENVOICEOS_PATH/package/python-pafy/Config.in"
	source "$BR2_EXTERNAL_OPENVOICEOS_PATH/package/python-pako/Config.in"
	source "$BR2_EXTERNAL_OPENVOICEOS_PATH/package/python-pep8/Config.in"
	source "$BR2_EXTERNAL_OPENVOICEOS_PATH/package/python-petact/Config.in"
	source "$BR2_EXTERNAL_OPENVOICEOS_PATH/package/python-phoneme-guesser/Config.in"
	source "$BR2_EXTERNAL_OPENVOICEOS_PATH/package/python-pocketsphinx/Config.in"
	source "$BR2_EXTERNAL_OPENVOICEOS_PATH/package/python-pprintpp/Config.in"
	source "$BR2_EXTERNAL_OPENVOICEOS_PATH/package/python-precise-lite-runner/Config.in"
	source "$BR2_EXTERNAL_OPENVOICEOS_PATH/package/python-precise-runner/Config.in"
	source "$BR2_EXTERNAL_OPENVOICEOS_PATH/package/python-premailer/Config.in"
	source "$BR2_EXTERNAL_OPENVOICEOS_PATH/package/python-pulsectl/Config.in"
	source "$BR2_EXTERNAL_OPENVOICEOS_PATH/package/python-pyaudio/Config.in"
	source "$BR2_EXTERNAL_OPENVOICEOS_PATH/package/python-pychromecast/Config.in"
	source "$BR2_EXTERNAL_OPENVOICEOS_PATH/package/python-pycpuinfo/Config.in"
	source "$BR2_EXTERNAL_OPENVOICEOS_PATH/package/python-pyee/Config.in"
	source "$BR2_EXTERNAL_OPENVOICEOS_PATH/package/python-pyftdi/Config.in"
	source "$BR2_EXTERNAL_OPENVOICEOS_PATH/package/python-pygithub/Config.in"
	source "$BR2_EXTERNAL_OPENVOICEOS_PATH/package/python-pyjokes/Config.in"
	source "$BR2_EXTERNAL_OPENVOICEOS_PATH/package/python-pymeeus/Config.in"
	source "$BR2_EXTERNAL_OPENVOICEOS_PATH/package/python-pymplayer/Config.in"
	source "$BR2_EXTERNAL_OPENVOICEOS_PATH/package/python-pyowm/Config.in"
	source "$BR2_EXTERNAL_OPENVOICEOS_PATH/package/python-pythran/Config.in"
	source "$BR2_EXTERNAL_OPENVOICEOS_PATH/package/python-pytube/Config.in"
	source "$BR2_EXTERNAL_OPENVOICEOS_PATH/package/python-pytzdata/Config.in"
	source "$BR2_EXTERNAL_OPENVOICEOS_PATH/package/python-pywebio/Config.in"
	source "$BR2_EXTERNAL_OPENVOICEOS_PATH/package/python-pyxdg/Config.in"
	source "$BR2_EXTERNAL_OPENVOICEOS_PATH/package/python-quantulum3/Config.in"
	source "$BR2_EXTERNAL_OPENVOICEOS_PATH/package/python-quebra-frases/Config.in"
	source "$BR2_EXTERNAL_OPENVOICEOS_PATH/package/python-rakekeywords/Config.in"
	source "$BR2_EXTERNAL_OPENVOICEOS_PATH/package/python-rapidfuzz/Config.in"
	source "$BR2_EXTERNAL_OPENVOICEOS_PATH/package/python-ratelim/Config.in"
	source "$BR2_EXTERNAL_OPENVOICEOS_PATH/package/python-requests-cache/Config.in"
	source "$BR2_EXTERNAL_OPENVOICEOS_PATH/package/python-requests-futures/Config.in"
	source "$BR2_EXTERNAL_OPENVOICEOS_PATH/package/python-reverse-geocoder/Config.in"
	source "$BR2_EXTERNAL_OPENVOICEOS_PATH/package/python-ruamel-yaml/Config.in"
	source "$BR2_EXTERNAL_OPENVOICEOS_PATH/package/python-scipy/Config.in"
	source "$BR2_EXTERNAL_OPENVOICEOS_PATH/package/python-sgmllib3k/Config.in"
	source "$BR2_EXTERNAL_OPENVOICEOS_PATH/package/python-simplematch/Config.in"
	source "$BR2_EXTERNAL_OPENVOICEOS_PATH/package/python-smbus2/Config.in"
	source "$BR2_EXTERNAL_OPENVOICEOS_PATH/package/python-smmap/Config.in"
	source "$BR2_EXTERNAL_OPENVOICEOS_PATH/package/python-sonopy/Config.in"
	source "$BR2_EXTERNAL_OPENVOICEOS_PATH/package/python-source/Config.in"
	source "$BR2_EXTERNAL_OPENVOICEOS_PATH/package/python-speech2text/Config.in"
	source "$BR2_EXTERNAL_OPENVOICEOS_PATH/package/python-speechrecognition/Config.in"
	source "$BR2_EXTERNAL_OPENVOICEOS_PATH/package/python-srt/Config.in"
	source "$BR2_EXTERNAL_OPENVOICEOS_PATH/package/python-stopwordsiso/Config.in"
	source "$BR2_EXTERNAL_OPENVOICEOS_PATH/package/python-sysv-ipc/Config.in"
	source "$BR2_EXTERNAL_OPENVOICEOS_PATH/package/python-tailhead/Config.in"
	source "$BR2_EXTERNAL_OPENVOICEOS_PATH/package/python-tbm-utils/Config.in"
	source "$BR2_EXTERNAL_OPENVOICEOS_PATH/package/python-tflit/Config.in"
	source "$BR2_EXTERNAL_OPENVOICEOS_PATH/package/python-timezonefinder/Config.in"
	source "$BR2_EXTERNAL_OPENVOICEOS_PATH/package/python-tutubo/Config.in"
	source "$BR2_EXTERNAL_OPENVOICEOS_PATH/package/python-tzlocal/Config.in"
	source "$BR2_EXTERNAL_OPENVOICEOS_PATH/package/python-ua-parser/Config.in"
	source "$BR2_EXTERNAL_OPENVOICEOS_PATH/package/python-unidecode/Config.in"
	source "$BR2_EXTERNAL_OPENVOICEOS_PATH/package/python-uritemplate/Config.in"
	source "$BR2_EXTERNAL_OPENVOICEOS_PATH/package/python-url-normalize/Config.in"
	source "$BR2_EXTERNAL_OPENVOICEOS_PATH/package/python-user-agents/Config.in"
	source "$BR2_EXTERNAL_OPENVOICEOS_PATH/package/python-vlc/Config.in"
	source "$BR2_EXTERNAL_OPENVOICEOS_PATH/package/python-vosk-api/Config.in"
	source "$BR2_EXTERNAL_OPENVOICEOS_PATH/package/python-webrtcvad/Config.in"
	source "$BR2_EXTERNAL_OPENVOICEOS_PATH/package/python-wheel/Config.in"
	source "$BR2_EXTERNAL_OPENVOICEOS_PATH/package/python-wikipedia-api/Config.in"
	source "$BR2_EXTERNAL_OPENVOICEOS_PATH/package/python-wikipedia-for-humans/Config.in"
	source "$BR2_EXTERNAL_OPENVOICEOS_PATH/package/python-xmlrunner/Config.in"
	source "$BR2_EXTERNAL_OPENVOICEOS_PATH/package/python-xxhash/Config.in"
	source "$BR2_EXTERNAL_OPENVOICEOS_PATH/package/python-yagmail/Config.in"
	source "$BR2_EXTERNAL_OPENVOICEOS_PATH/package/python-youtube-dl/Config.in"
	source "$BR2_EXTERNAL_OPENVOICEOS_PATH/package/python-youtube-searcher/Config.in"
	source "$BR2_EXTERNAL_OPENVOICEOS_PATH/package/python-yt-dlp/Config.in"
	source "$BR2_EXTERNAL_OPENVOICEOS_PATH/package/python-ytmusicapi/Config.in"
endmenu
menu "OpenVoiceOS - Personal Assistant"
menu "Core"
	source "$BR2_EXTERNAL_OPENVOICEOS_PATH/package/mycroft-gui/Config.in"
	source "$BR2_EXTERNAL_OPENVOICEOS_PATH/package/python-ovos-cli-client/Config.in"
	source "$BR2_EXTERNAL_OPENVOICEOS_PATH/package/python-ovos-config/Config.in"
	source "$BR2_EXTERNAL_OPENVOICEOS_PATH/package/python-ovos-core/Config.in"
	source "$BR2_EXTERNAL_OPENVOICEOS_PATH/package/mycroft-service/Config.in"
endmenu
menu "Plugins"
	source "$BR2_EXTERNAL_OPENVOICEOS_PATH/package/python-ovos-audio-plugin-simple/Config.in"
	source "$BR2_EXTERNAL_OPENVOICEOS_PATH/package/python-ovos-backend-client/Config.in"
	source "$BR2_EXTERNAL_OPENVOICEOS_PATH/package/python-ovos-backend-manager/Config.in"
	source "$BR2_EXTERNAL_OPENVOICEOS_PATH/package/python-ovos-config-assistant/Config.in"
	source "$BR2_EXTERNAL_OPENVOICEOS_PATH/package/python-ovos-lingua-franca/Config.in"
	source "$BR2_EXTERNAL_OPENVOICEOS_PATH/package/python-ovos-local-backend/Config.in"
	source "$BR2_EXTERNAL_OPENVOICEOS_PATH/package/python-ovos-notifications-service/Config.in"
	source "$BR2_EXTERNAL_OPENVOICEOS_PATH/package/python-ovos-ocp-audio-plugin/Config.in"
	source "$BR2_EXTERNAL_OPENVOICEOS_PATH/package/python-ovos-phal/Config.in"
	source "$BR2_EXTERNAL_OPENVOICEOS_PATH/package/python-ovos-phal-plugin-alsa/Config.in"
	source "$BR2_EXTERNAL_OPENVOICEOS_PATH/package/python-ovos-phal-plugin-balena-wifi/Config.in"
	source "$BR2_EXTERNAL_OPENVOICEOS_PATH/package/python-ovos-phal-plugin-brightness-control-rpi/Config.in"
	source "$BR2_EXTERNAL_OPENVOICEOS_PATH/package/python-ovos-phal-plugin-color-scheme-manager/Config.in"
	source "$BR2_EXTERNAL_OPENVOICEOS_PATH/package/python-ovos-phal-plugin-configuration-provider/Config.in"
	source "$BR2_EXTERNAL_OPENVOICEOS_PATH/package/python-ovos-phal-plugin-connectivity-events/Config.in"
	source "$BR2_EXTERNAL_OPENVOICEOS_PATH/package/python-ovos-phal-plugin-dashboard/Config.in"
	source "$BR2_EXTERNAL_OPENVOICEOS_PATH/package/python-ovos-phal-plugin-display-manager-ipc/Config.in"
	source "$BR2_EXTERNAL_OPENVOICEOS_PATH/package/python-ovos-phal-plugin-gui-network-client/Config.in"
	source "$BR2_EXTERNAL_OPENVOICEOS_PATH/package/python-ovos-phal-plugin-gpsd/Config.in"
	source "$BR2_EXTERNAL_OPENVOICEOS_PATH/package/python-ovos-phal-plugin-ipc2bus/Config.in"
	source "$BR2_EXTERNAL_OPENVOICEOS_PATH/package/python-ovos-phal-plugin-ipgeo/Config.in"
	source "$BR2_EXTERNAL_OPENVOICEOS_PATH/package/python-ovos-phal-plugin-mk1/Config.in"
	source "$BR2_EXTERNAL_OPENVOICEOS_PATH/package/python-ovos-phal-plugin-mk2/Config.in"
	source "$BR2_EXTERNAL_OPENVOICEOS_PATH/package/python-ovos-phal-plugin-network-manager/Config.in"
	source "$BR2_EXTERNAL_OPENVOICEOS_PATH/package/python-ovos-phal-plugin-notification-widgets/Config.in"
	source "$BR2_EXTERNAL_OPENVOICEOS_PATH/package/python-ovos-phal-plugin-respeaker-2mic/Config.in"
	source "$BR2_EXTERNAL_OPENVOICEOS_PATH/package/python-ovos-phal-plugin-respeaker-4mic/Config.in"
	source "$BR2_EXTERNAL_OPENVOICEOS_PATH/package/python-ovos-phal-plugin-system/Config.in"
	source "$BR2_EXTERNAL_OPENVOICEOS_PATH/package/python-ovos-phal-plugin-wifi-setup/Config.in"
	source "$BR2_EXTERNAL_OPENVOICEOS_PATH/package/python-ovos-plugin-manager/Config.in"
	source "$BR2_EXTERNAL_OPENVOICEOS_PATH/package/python-ovos-skill-installer/Config.in"
	source "$BR2_EXTERNAL_OPENVOICEOS_PATH/package/python-ovos-skill-manager/Config.in"
	source "$BR2_EXTERNAL_OPENVOICEOS_PATH/package/python-ovos-stt-http-server/Config.in"
	source "$BR2_EXTERNAL_OPENVOICEOS_PATH/package/python-ovos-stt-plugin-chromium/Config.in"
	source "$BR2_EXTERNAL_OPENVOICEOS_PATH/package/python-ovos-stt-plugin-pocketsphinx/Config.in"
	source "$BR2_EXTERNAL_OPENVOICEOS_PATH/package/python-ovos-stt-plugin-selene/Config.in"
	source "$BR2_EXTERNAL_OPENVOICEOS_PATH/package/python-ovos-stt-plugin-vosk/Config.in"
	source "$BR2_EXTERNAL_OPENVOICEOS_PATH/package/python-ovos-stt-plugin-whispercpp/Config.in"
	source "$BR2_EXTERNAL_OPENVOICEOS_PATH/package/python-ovos-stt-server-plugin/Config.in"
	source "$BR2_EXTERNAL_OPENVOICEOS_PATH/package/python-neon-tts-plugin-larynx_server/Config.in"
	source "$BR2_EXTERNAL_OPENVOICEOS_PATH/package/python-ovos-tts-plugin-marytts/Config.in"
	source "$BR2_EXTERNAL_OPENVOICEOS_PATH/package/python-ovos-tts-plugin-mimic/Config.in"
	source "$BR2_EXTERNAL_OPENVOICEOS_PATH/package/python-ovos-tts-plugin-mimic2/Config.in"
	source "$BR2_EXTERNAL_OPENVOICEOS_PATH/package/python-ovos-tts-plugin-mimic3-server/Config.in"
	source "$BR2_EXTERNAL_OPENVOICEOS_PATH/package/python-ovos-tts-plugin-pico/Config.in"
	source "$BR2_EXTERNAL_OPENVOICEOS_PATH/package/python-ovos-tts-server/Config.in"
	source "$BR2_EXTERNAL_OPENVOICEOS_PATH/package/python-ovos-tts-server-plugin/Config.in"
	source "$BR2_EXTERNAL_OPENVOICEOS_PATH/package/python-ovos-utils/Config.in"
	source "$BR2_EXTERNAL_OPENVOICEOS_PATH/package/python-ovos-vad-plugin-webrtcvad/Config.in"
	source "$BR2_EXTERNAL_OPENVOICEOS_PATH/package/python-ovos-vlc-plugin/Config.in"
	source "$BR2_EXTERNAL_OPENVOICEOS_PATH/package/python-ovos-workshop/Config.in"
	source "$BR2_EXTERNAL_OPENVOICEOS_PATH/package/python-ovos-ww-plugin-pocketsphinx/Config.in"
	source "$BR2_EXTERNAL_OPENVOICEOS_PATH/package/python-ovos-ww-plugin-precise/Config.in"
	source "$BR2_EXTERNAL_OPENVOICEOS_PATH/package/python-ovos-ww-plugin-precise-lite/Config.in"
	source "$BR2_EXTERNAL_OPENVOICEOS_PATH/package/python-ovos-ww-plugin-vosk/Config.in"
endmenu
menu "Skills"
	source "$BR2_EXTERNAL_OPENVOICEOS_PATH/package/skill-alerts/Config.in"
	source "$BR2_EXTERNAL_OPENVOICEOS_PATH/package/skill-camera/Config.in"
	source "$BR2_EXTERNAL_OPENVOICEOS_PATH/package/mycroft-skill-osm/Config.in"
	source "$BR2_EXTERNAL_OPENVOICEOS_PATH/package/skill-local-music/Config.in"
	source "$BR2_EXTERNAL_OPENVOICEOS_PATH/package/skill-ovos-alarm/Config.in"
	source "$BR2_EXTERNAL_OPENVOICEOS_PATH/package/skill-ovos-date-time/Config.in"
	source "$BR2_EXTERNAL_OPENVOICEOS_PATH/package/skill-ovos-ddg/Config.in"
	source "$BR2_EXTERNAL_OPENVOICEOS_PATH/package/skill-ovos-fallback-unknown/Config.in"
	source "$BR2_EXTERNAL_OPENVOICEOS_PATH/package/skill-ovos-filebrowser/Config.in"
	source "$BR2_EXTERNAL_OPENVOICEOS_PATH/package/skill-ovos-homescreen/Config.in"
	source "$BR2_EXTERNAL_OPENVOICEOS_PATH/package/skill-ovos-info/Config.in"
	source "$BR2_EXTERNAL_OPENVOICEOS_PATH/package/skill-ovos-naptime/Config.in"
	source "$BR2_EXTERNAL_OPENVOICEOS_PATH/package/skill-ovos-news/Config.in"
	source "$BR2_EXTERNAL_OPENVOICEOS_PATH/package/skill-ovos-notes/Config.in"
	source "$BR2_EXTERNAL_OPENVOICEOS_PATH/package/skill-ovos-settings/Config.in"
	source "$BR2_EXTERNAL_OPENVOICEOS_PATH/package/skill-ovos-setup/Config.in"
	source "$BR2_EXTERNAL_OPENVOICEOS_PATH/package/skill-ovos-stop/Config.in"
	source "$BR2_EXTERNAL_OPENVOICEOS_PATH/package/skill-ovos-timer/Config.in"
	source "$BR2_EXTERNAL_OPENVOICEOS_PATH/package/skill-ovos-volume/Config.in"
	source "$BR2_EXTERNAL_OPENVOICEOS_PATH/package/mycroft-skill-parrot/Config.in"
	source "$BR2_EXTERNAL_OPENVOICEOS_PATH/package/skill-ovos-personal/Config.in"
	source "$BR2_EXTERNAL_OPENVOICEOS_PATH/package/skill-ovos-weather/Config.in"
	source "$BR2_EXTERNAL_OPENVOICEOS_PATH/package/skill-ovos-wolfie/Config.in"
	source "$BR2_EXTERNAL_OPENVOICEOS_PATH/package/mycroft-skill-wikipedia-for-humans/Config.in"
	source "$BR2_EXTERNAL_OPENVOICEOS_PATH/package/skill-youtube-music/Config.in"
endmenu
endmenu
```
