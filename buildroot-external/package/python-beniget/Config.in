## buildroot-external/package/python-beniget/Config.in
```kconfig
config BR2_PACKAGE_PYTHON_BENIGET
	bool "python-beniget"
	select BR2_PACKAGE_PYTHON_GAST # runtime
	help
	  Extract semantic information about static Python code.

	  https://github.com/serge-sans-paille/beniget/
```

## buildroot-external/package/python-bitstruct/Config.in
```kconfig
config BR2_PACKAGE_PYTHON_BITSTRUCT
	bool "python-bitstruct"
	help
	  This module performs conversions between Python values and
	  C bit field structs represented as Python byte strings.

	  https://github.com/eerimoq/bitstruct
```

## buildroot-external/package/python-board/Config.in
```kconfig
config BR2_PACKAGE_PYTHON_BOARD
	bool "python-board"
	help
	  Standard Board mechanism for Dojo tasks.

	  https://github.com/tjguk/dojo-board
```

## buildroot-external/package/python-casttube/Config.in
```kconfig
config BR2_PACKAGE_PYTHON_CASTTUBE
	bool "python-casttube"
	select BR2_PACKAGE_PYTHON_REQUESTS # runtime
	help
	  YouTube chromecast api.

	  http://github.com/ur1katz/casttube
```

## buildroot-external/package/python-click-default-group/Config.in
```kconfig
config BR2_PACKAGE_PYTHON_CLICK_DEFAULT_GROUP
	bool "python-click-default-group"
	select BR2_PACKAGE_PYTHON_CLICK # runtime
	help
	  Extends click.Group to invoke a command without explicit
	  subcommand name.

	  https://github.com/sublee/click-default-group/
```

## buildroot-external/package/python-colorzero/Config.in
```kconfig
config BR2_PACKAGE_PYTHON_COLORZERO
	bool "python-colorzero"
	help
	  Yet another Python color library.

	  http://colorzero.readthedocs.io/
```

## buildroot-external/package/python-colour/Config.in
```kconfig
config BR2_PACKAGE_PYTHON_COLOUR
	bool "python-colour"
	help
	  Converts and manipulates common color 
	  representation (RGB, HSL, web, …)

	  https://github.com/vaab/colour
```

## buildroot-external/package/python-combo-lock/Config.in
```kconfig
config BR2_PACKAGE_PYTHON_COMBO_LOCK
	bool "python-combo-lock"
	help
	  Python combo_lock package 

	  https://pypi.org/project/combo-lock/
```

## buildroot-external/package/python-convertdate/Config.in
```kconfig
config BR2_PACKAGE_PYTHON_CONVERTDATE
	bool "python-convertdate"
	select BR2_PACKAGE_PYTHON_PYMEEUS # runtime
	select BR2_PACKAGE_PYTHON_PYTZ # runtime
	help
	  Converts between Gregorian dates and other calendar
	  systems.Calendars included: Baha'i, French Republican,
	  Hebrew, Indian Civil, Islamic, ISO, Julian, Mayan and
	  Persian.

	  https://github.com/fitnr/convertdate
```

## buildroot-external/package/python-coverage/Config.in
```kconfig
config BR2_PACKAGE_PYTHON_COVERAGE
	bool "python-coverage"
	help
	  Code coverage measurement for Python.

	  https://bitbucket.org/ned/coveragepy
```

## buildroot-external/package/python-coveralls/Config.in
```kconfig
config BR2_PACKAGE_PYTHON_COVERALLS
	bool "python-coveralls"
	select BR2_PACKAGE_PYTHON_DOCOPT # runtime
	select BR2_PACKAGE_PYTHON_COVERAGE # runtime
	select BR2_PACKAGE_PYTHON_REQUESTS # runtime
	help
	  Show coverage stats online via coveralls.io.

	  http://github.com/coveralls-clients/coveralls-python
```

## buildroot-external/package/python-cutecharts/Config.in
```kconfig
config BR2_PACKAGE_PYTHON_CUTECHARTS
	bool "python-cutecharts"
	help
	  Hand drawing style charts library for Python 

	  https://github.com/cutecharts/cutecharts.py
```

## buildroot-external/package/python-dbus-next/Config.in
```kconfig
config BR2_PACKAGE_PYTHON_DBUS_NEXT
	bool "python-dbus-next"
	help
	  A zero-dependency DBus library for Python with asyncio
	  support.

	  https://github.com/altdesktop/python-dbus-next
```

## buildroot-external/package/python-deprecated/Config.in
```kconfig
config BR2_PACKAGE_PYTHON_DEPRECATED
	bool "python-deprecated"
	help
	  Python @deprecated decorator to deprecate 
	  old python classes, functions or methods..

	  https://github.com/tantale/deprecated
```

## buildroot-external/package/python-fann2/Config.in
```kconfig
config BR2_PACKAGE_PYTHON_FANN2
	bool "python-fann2"
	depends on BR2_PACKAGE_PYTHON3
	help
	  Fast Artificial Neural Network Library (FANN) Python bindings.

	  https://github.com/FutureLinkCorporation/fann2
```

## buildroot-external/package/python-fasteners/Config.in
```kconfig
config BR2_PACKAGE_PYTHON_FASTENERS
	bool "python-fasteners"
	select BR2_PACKAGE_PYTHON_MONOTONIC # runtime
	select BR2_PACKAGE_PYTHON_SIX # runtime
	help
	  A python package that provides useful locks.

	  https://github.com/harlowja/fasteners
```

## buildroot-external/package/python-feedparser/Config.in
```kconfig
config BR2_PACKAGE_PYTHON_FEEDPARSER
	bool "python-feedparser"
	help
	  Universal feed parser, handles RSS 0.9x, RSS 1.0, RSS 2.0,
	  CDF, Atom 0.3, and Atom 1.0 feeds.

	  https://github.com/kurtmckee/feedparser
```

## buildroot-external/package/python-flask-fontawesome/Config.in
```kconfig
config BR2_PACKAGE_PYTHON_FLASK_FONTAWESOME
	bool "python-flask-fontawesome"
	select BR2_PACKAGE_PYTHON_FLASK # runtime
	help
	  FontAwesome for Flask.

	  https://github.com/heartsucker/flask-fontawesome
```

## buildroot-external/package/python-flask-mail/Config.in
```kconfig
config BR2_PACKAGE_PYTHON_FLASK_MAIL
	bool "python-flask-mail"
	select BR2_PACKAGE_PYTHON_BLINKER # runtime
	select BR2_PACKAGE_PYTHON_FLASK # runtime
	help
	  Flask extension for sending email.

	  https://github.com/rduplain/flask-mail
```

## buildroot-external/package/python-flask-simplelogin/Config.in
```kconfig
config BR2_PACKAGE_PYTHON_FLASK_SIMPLELOGIN
	bool "python-flask-simplelogin"
	select BR2_PACKAGE_PYTHON_CLICK # runtime
	select BR2_PACKAGE_PYTHON_FLASK # runtime
	select BR2_PACKAGE_PYTHON_FLASK_WTF # runtime
	help
	  Flask Simple Login - Login Extension for Flask.

	  https://github.com/flask-extensions/Flask-SimpleLogin
```

## buildroot-external/package/python-flask-socketio/Config.in
```kconfig
config BR2_PACKAGE_PYTHON_FLASK_SOCKETIO
	bool "python-flask-socketio"
	help
	  Socket.IO integration for Flask applications.

	  https://github.com/miguelgrinberg/flask-socketio
```

## buildroot-external/package/python-gast/Config.in
```kconfig
config BR2_PACKAGE_PYTHON_GAST
	bool "python-gast"
	help
	  Python AST that abstracts the underlying Python version.

	  https://github.com/serge-sans-paille/gast/
```

## buildroot-external/package/python-geocoder/Config.in
```kconfig
config BR2_PACKAGE_PYTHON_GEOCODER
	bool "python-geocoder"
	select BR2_PACKAGE_PYTHON_CLICK # runtime
	select BR2_PACKAGE_PYTHON_FUTURE # runtime
	select BR2_PACKAGE_PYTHON_RATELIM # runtime
	select BR2_PACKAGE_PYTHON_REQUESTS # runtime
	select BR2_PACKAGE_PYTHON_SIX # runtime
	help
	  Geocoder is a simple and consistent geocoding library.

	  https://github.com/DenisCarriere/geocoder
```

## buildroot-external/package/python-geoip-geolite2/Config.in
```kconfig
config BR2_PACKAGE_PYTHON_GEOIP_GEOLITE2
	bool "python-geoip-geolite2"
	select BR2_PACKAGE_PYTHON_GEOIP # runtime
	help
	  Provides access to the geolite2 database.  This product
	  includes GeoLite2 data created by MaxMind, available from
	  http://www.maxmind.com/.

	  http://github.com/mitsuhiko/python-geoip
```

## buildroot-external/package/python-geoip/Config.in
```kconfig
config BR2_PACKAGE_PYTHON_GEOIP
	bool "python-geoip"
	help
	  Provides GeoIP functionality for Python.

	  http://github.com/mitsuhiko/python-geoip
```
