## buildroot-external/package/mycroft-skill-youtube-music/Config.in
```kconfig
config BR2_PACKAGE_MYCROFT_SKILL_YOUTUBE_MUSIC
	bool "mycroft-skill-youtube-music"
	help
	  play music from youtube in mycroft

	  https://github.com/JarbasSkills/skill-youtube-music
```

## buildroot-external/package/mycroft-skills-repo/Config.in
```kconfig
config BR2_PACKAGE_MYCROFT_SKILLS_REPO
	bool "mycroft-skills-repo"
	help
	  Mycroft AI - Skills Repo
	  The official home of Skills for the Mycroft 
	  ecosystem. These Skills are written by both 
	  the MycroftAI team and others within the Community.

	  https://github.com/MycroftAI/mycroft-skills
```

## buildroot-external/package/mycroft-splash/Config.in
```kconfig
config BR2_PACKAGE_MYCROFT_SPLASH
	bool "mycroft-splash"
	help
	  Show Mycroft A.I. branded splash screens on boot/halt.

	  https://mycroft.ai/ https://www.j1nx.nl
```

## buildroot-external/package/mycroftos/Config.in
```kconfig
menuconfig BR2_PACKAGE_MYCROFTOS
	bool "mycroftos-app"
	help
	  This is the Application layer that builds the
	  Mycroft A.I. software stack on top of Buildroot
	  with defaults packages and configurations.

	  https://github.com/j1nx/MycroftOS/
```

## buildroot-external/package/ncpamixer/Config.in
```kconfig
config BR2_PACKAGE_NCPAMIXER
	bool "ncpamixer"
	help
	  An ncurses mixer for PulseAudio inspired by pavucontrol..

	  https://github.com/fulhax/ncpamixer
```

## buildroot-external/package/neon2sse/Config.in
```kconfig
config BR2_PACKAGE_NEON2SSE
	bool "neon2sse"
	help
	  NEON_2_SSE.h file is intended to simplify ARM->IA32 porting.

	  https://github.com/intel/ARM_NEON_2_x86_SSE
```

## buildroot-external/package/nodogsplash/Config.in
```kconfig
config BR2_PACKAGE_NODOGSPLASH
	bool "nodogsplash"
	select BR2_PACKAGE_LIBMICROHTTPD
	help
	  Nodogspash (NDS) is a high performance, 
	  small footprint Captive Portal, offering 
	  by default a simple splash page restricted 
	  Internet connection, yet incorporates an 
	  API that allows the creation of 
	  sophisticated authentication applications.

	  https://github.com/nodogsplash/nodogsplash
```

## buildroot-external/package/opencl_headers/Config.in
```kconfig
config BR2_PACKAGE_OPENCL_HEADERS
	bool "opencl_headers"
	help
	  Header-only library for Khronos OpenCL-Headers.

	  https://github.com/KhronosGroup/OpenCL-Headers
```

## buildroot-external/package/openfec/Config.in
```kconfig
config BR2_PACKAGE_OPENFEC
	bool "openfec"
	help
	  Unofficial OpenFEC fork with various bugfixes.

	  https://github.com/roc-streaming/openfec
```

## buildroot-external/package/openfst/Config.in
```kconfig
config BR2_PACKAGE_OPENFST
	bool "openfst"
	help
	  Port of the OpenFST library to Windows

	  https://github.com/kkm000/openfst
```

## buildroot-external/package/ovos-bus-server/Config.in
```kconfig
config BR2_PACKAGE_OVOS_BUS_SERVER
	bool "ovos-bus-server"
	help
	  alternative ovos bus service (websocket server) in C++

	  https://github.com/OpenVoiceOS/ovos-bus-server
```

## buildroot-external/package/ovos-containers/Config.in
```kconfig
menuconfig BR2_PACKAGE_OVOS_CONTAINERS
	bool "Pre-install OVOS containers"
	help
	  This is the system layer that prepares and
	  pre-install the required OVOS containers.

	  https://github.com/OpenVoiceOS/ovos-docker

if BR2_PACKAGE_OVOS_CONTAINERS

config BR2_PACKAGE_OVOS_CONTAINERS_ARCH
	string "Container Arch"
	help
	  Architecture for which we should be pull.

choice
	prompt "Containers to pre-install"
	default BR2_PACKAGE_OVOS_CONTAINERS_HEADLESS

config BR2_PACKAGE_OVOS_CONTAINERS_HEADLESS
	bool "Headless"
	help
	  This install all minimal required containers
	  to run the OVOS framework headless.

	  Install: - ovos-phal 
		   - ovos-listener-dinkum 
		   - ovos-audio
		   - ovos-core
		   - ovos-cli

config BR2_PACKAGE_OVOS_CONTAINERS_GUI
        bool "Graphical User Interface"
        help
          This install all required containers
          to run the OVOS framework with the QT5
	  Graphical User Interface enabled.

          Install: - ovos-phal
                   - ovos-listener-dinkum
                   - ovos-audio
                   - ovos-core
                   - ovos-cli
		   - ovos-gui-websocket
		   - ovos-gui-shell

endchoice

endif
```

## buildroot-external/package/ovos-dashboard/Config.in
```kconfig
config BR2_PACKAGE_OVOS_DASHBOARD
	bool "ovos-dashboard"
	help
	  OpenVoiceOS Dashboard Application

	  https://github.com/OpenVoiceOS/OVOS-Dashboard
```

## buildroot-external/package/ovos-rust-messagebus/Config.in
```kconfig
config BR2_PACKAGE_OVOS_RUST_MESSAGEBUS
	bool "ovos-rust-messagebus"
	depends on BR2_PACKAGE_HOST_RUSTC_TARGET_ARCH_SUPPORTS
	select BR2_PACKAGE_HOST_CARGO
        help
	  This is a Rust implementation of the OpenVoiceOS (OVOS) 
	  messagebus, providing a fast and efficient communication 
	  backbone for OVOS components. Think of it as the "nervous system" 
	  of the OVOS platform.
```

## buildroot-external/package/ovos-shell/Config.in
```kconfig
config BR2_PACKAGE_OVOS_SHELL
	bool "ovos-shell"
	help
	  This is a minimal shell which is intended 
	  to run on low power hardware either as "single 
	  application" on a minimal wayland server or 
	  with eglfs backend.

	  https://github.com/OpenVoiceOS/ovos-shell
```

## buildroot-external/package/pa-volume/Config.in
```kconfig
config BR2_PACKAGE_PA_VOLUME
	bool "pa-volume"
	help
	  Allows to set volume of non-active pulseaudio clients

	  https://github.com/rhaas80/pa_volume
```

## buildroot-external/package/picotts/Config.in
```kconfig
config BR2_PACKAGE_PICOTTS
	bool "picotts"
	help
	  Text to speech voice sinthesizer from SVox, 
	  included in Android AOSP.

	  https://github.com/naggety/picotts
```

## buildroot-external/package/prepare_system-service/Config.in
```kconfig
config BR2_PACKAGE_PREPARE_SYSTEM_SERVICE
	bool "prepare_system-service"
	help
	  A systemd service that prepares the system.
	  Used to change/move files before everything
	  gets loaded.
```

## buildroot-external/package/pthreadpool/Config.in
```kconfig
config BR2_PACKAGE_PTHREADPOOL
	bool "pthreadpool"
	select BR2_PACKAGE_FXDIV
	help
	  Portable (POSIX/Windows/Emscripten) thread pool for C/C++

	  https://github.com/Maratyszcza/pthreadpool/
```

## buildroot-external/package/python-adafruit-blinka/Config.in
```kconfig
config BR2_PACKAGE_PYTHON_ADAFRUIT_BLINKA
	bool "python-adafruit-blinka"
	select BR2_PACKAGE_PYTHON_ADAFRUIT_CIRCUITPYTHON_TYPING # runtime
	select BR2_PACKAGE_PYTHON_ADAFRUIT_PLATFORMDETECT # runtime
	select BR2_PACKAGE_PYTHON_ADAFRUIT_PUREIO # runtime
	select BR2_PACKAGE_PYTHON_PYFTDI # runtime
	help
	  CircuitPython APIs for non-CircuitPython versions of Python
	  such as CPython on Linux and MicroPython.

	  https://github.com/adafruit/Adafruit_Blinka
```

## buildroot-external/package/python-adafruit-circuitpython-neopixel/Config.in
```kconfig
config BR2_PACKAGE_PYTHON_ADAFRUIT_CIRCUITPYTHON_NEOPIXEL
	bool "python-adafruit-circuitpython-neopixel"
	help
	  Higher level NeoPixel driver that presents the strip 
	  as a sequence. This is a supercharged version of the 
	  original MicroPython driver. 

	  https://github.com/adafruit/Adafruit_CircuitPython_NeoPixel
```

## buildroot-external/package/python-adafruit-platformdetect/Config.in
```kconfig
config BR2_PACKAGE_PYTHON_ADAFRUIT_PLATFORMDETECT
	bool "python-adafruit-platformdetect"
	help
	  Platform detection for use by libraries like Adafruit-
	  Blinka.

	  https://github.com/adafruit/Adafruit_Python_PlatformDetect
```

## buildroot-external/package/python-adapt-parser/Config.in
```kconfig
config BR2_PACKAGE_PYTHON_ADAPT_PARSER
	bool "python-adapt-parser"
	select BR2_PACKAGE_PYTHON_PYEE # runtime
	select BR2_PACKAGE_PYTHON_SIX # runtime
	help
	  A text-to-intent parsing framework.

	  https://github.com/MycroftAI/adapt
```

## buildroot-external/package/python-astral/Config.in
```kconfig
config BR2_PACKAGE_PYTHON_ASTRAL
	bool "python-astral"
	help
	  This is ‘astral’ a Python module which calculates
	  - Times for various positions of the sun: dawn, 
	    sunrise, solar noon, sunset, dusk, solar elevation, 
	    solar azimuth and rahukaalam.
	  - The phase of the moon.

	  https://github.com/sffjunkie/astral
```

## buildroot-external/package/python-audio-metadata/Config.in
```kconfig
config BR2_PACKAGE_PYTHON_AUDIO_METADATA
	bool "python-audio-metadata"
	select BR2_PACKAGE_PYTHON_ATTRS # runtime
	select BR2_PACKAGE_PYTHON_BIDICT # runtime
	select BR2_PACKAGE_PYTHON_BITSTRUCT # runtime
	select BR2_PACKAGE_PYTHON_MORE_ITERTOOLS # runtime
	select BR2_PACKAGE_PYTHON_PENDULUM # runtime
	select BR2_PACKAGE_PYTHON_PPRINTPP # runtime
	select BR2_PACKAGE_PYTHON_TBM_UTILS # runtime
	select BR2_PACKAGE_PYTHON_WRAPT # runtime
	help
	  A library for reading and, in the future, writing metadata
	  from audio files.

	  https://github.com/thebigmunch/audio-metadata
```
