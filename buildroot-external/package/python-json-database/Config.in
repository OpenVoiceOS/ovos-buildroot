## buildroot-external/package/python-json-database/Config.in
```kconfig
config BR2_PACKAGE_PYTHON_JSON_DATABASE
	bool "python-json-database"
	select BR2_PACKAGE_PYTHON_FASTENERS # runtime
	select BR2_PACKAGE_PYTHON_PYXDG # runtime
	help
	  searchable json database with persistence.

	  https://github.com/HelloChatterbox/json_database
```

## buildroot-external/package/python-korean-lunar-calendar/Config.in
```kconfig
config BR2_PACKAGE_PYTHON_KOREAN_LUNAR_CALENDAR
	bool "python-korean-lunar-calendar"
	help
	  Korean Lunar Calendar.

	  https://github.com/usingsky/korean_lunar_calendar_py
```

## buildroot-external/package/python-kthread/Config.in
```kconfig
config BR2_PACKAGE_PYTHON_KTHREAD
	bool "python-kthread"
	help
	  Killable threads in Python!.

	  https://github.com/munshigroup/kthread
```

## buildroot-external/package/python-langcodes/Config.in
```kconfig
config BR2_PACKAGE_PYTHON_LANGCODES
	bool "python-langcodes"
	help
	  Tools for labeling human languages with IETF language tags.

	  https://github.com/rspeer/langcodes
```

## buildroot-external/package/python-lazy/Config.in
```kconfig
config BR2_PACKAGE_PYTHON_LAZY
	bool "python-lazy"
	help
	  Lazy attributes for Python objects.

	  https://github.com/stefanholek/lazy
```

## buildroot-external/package/python-lingua-franca/Config.in
```kconfig
config BR2_PACKAGE_PYTHON_LINGUA_FRANCA
	bool "python-lingua-franca"
	select BR2_PACKAGE_PYTHON_DATEUTIL # runtime
	help
	  Mycroft's multilingual text parsing and formatting library.

	  https://github.com/MycroftAI/lingua-franca
```

## buildroot-external/package/python-lingua-nostra/Config.in
```kconfig
config BR2_PACKAGE_PYTHON_LINGUA_NOSTRA
	bool "python-lingua-nostra"
	select BR2_PACKAGE_PYTHON_DATEUTIL # runtime
	help
	  Mycroft's multilingual text parsing and formatting library.

	  https://github.com/HelloChatterbox/lingua-nostra
```

## buildroot-external/package/python-markdown-it-py/Config.in
```kconfig
config BR2_PACKAGE_PYTHON_MARKDOWN_IT_PY
	bool "python-markdown-it-py"
	help
	  This is a Python port of markdown-it, 
	  and some of its associated plugins.

	  https://github.com/executablebooks/markdown-it-py
```

## buildroot-external/package/python-mdurl/Config.in
```kconfig
config BR2_PACKAGE_PYTHON_MDURL
	bool "python-mdurl"
	help
	  This is a Python port of the JavaScript 
	  mdurl package. 

	  https://github.com/executablebooks/mdurl
```

## buildroot-external/package/python-memory-tempfile/Config.in
```kconfig
config BR2_PACKAGE_PYTHON_MEMORY_TEMPFILE
	bool "python-memory-tempfile"
	help
	  Helper functions to identify and use paths on the OS
	  (Linux-only for now) where RAM-based tempfiles can be
	  created.

	  https://github.com/mbello/memory-tempfile
```

## buildroot-external/package/python-mock-msm/Config.in
```kconfig
config BR2_PACKAGE_PYTHON_MOCK_MSM
	bool "python-mock-msm"
	help
	  The sole purpose of this pkg is to mock msm imports 

	  https://github.com/HelloChatterbox/mock-msm
```

## buildroot-external/package/python-monotonic/Config.in
```kconfig
config BR2_PACKAGE_PYTHON_MONOTONIC
	bool "python-monotonic"
	help
	  An implementation of time.monotonic() for Python 2 & < 3.3.

	  https://github.com/atdt/monotonic
```

## buildroot-external/package/python-msk/Config.in
```kconfig
config BR2_PACKAGE_PYTHON_MSK
	bool "python-msk"
	select BR2_PACKAGE_PYTHON_GITPYTHON # runtime
	select BR2_PACKAGE_PYTHON_TYPING # runtime
	select BR2_PACKAGE_PYTHON_MSM # runtime
	select BR2_PACKAGE_PYTHON_PYGITHUB # runtime
	help
	  Mycroft Skills Kit.

	  https://github.com/MycroftAI/mycroft-skills-kit
```

## buildroot-external/package/python-msm/Config.in
```kconfig
config BR2_PACKAGE_PYTHON_MSM
	bool "python-msm"
	select BR2_PACKAGE_PYTHON_GITPYTHON # runtime
	help
	  Mycroft Skills Manager.

	  https://github.com/MycroftAI/mycroft-skills-manager
```

## buildroot-external/package/python-multi-key-dict/Config.in
```kconfig
config BR2_PACKAGE_PYTHON_MULTI_KEY_DICT
	bool "python-multi-key-dict"
	help
	  Multi key dictionary implementation.

	  https://github.com/formiaczek/multi_key_dict
```

## buildroot-external/package/python-mycroft-lib/Config.in
```kconfig
config BR2_PACKAGE_PYTHON_MYCROFT_LIB
	bool "python-mycroft-lib"
	help
	  Mycroft Core, the Mycroft Artificial Intelligence platform.
	  packaged as importable library. 

	  https://mycroft.ai/
```

## buildroot-external/package/python-mycroft-messagebus-client/Config.in
```kconfig
config BR2_PACKAGE_PYTHON_MYCROFT_MESSAGEBUS_CLIENT
	bool "python-mycroft-messagebus-client"
	help
	  This module is a simple interface for the mycroft 
	  messagebus and can be used to connect to mycroft, 
	  send messages and react to messages sent by the 
	  Mycroft system.

	  https://github.com/MycroftAI/mycroft-messagebus-client
```

## buildroot-external/package/python-mycroft/Config.in
```kconfig
config BR2_PACKAGE_PYTHON_MYCROFT
	bool "python-mycroft"
	help
	  Mycroft Core, the Mycroft Artificial Intelligence platform.

	  https://mycroft.ai/
```

## buildroot-external/package/python-neon-lang-plugin-libretranslate/Config.in
```kconfig
config BR2_PACKAGE_PYTHON_NEON_LANG_PLUGIN_LIBRETRANSLATE
	bool "python-neon-lang-plugin-libretranslate"
	help
	  Language Plugin for LibreTranslate language 
	  detection and translation 

	  https://github.com/NeonGeckoCom/neon-lang-plugin-libretranslate
```

## buildroot-external/package/python-neon-phal-plugin-fan/Config.in
```kconfig
config BR2_PACKAGE_PYTHON_NEON_PHAL_PLUGIN_FAN
	bool "python-neon-phal-plugin-fan"
	help
	  PHAL Fan plugin

	  https://github.com/NeonGeckoCom/neon-phal-plugin-fan
```

## buildroot-external/package/python-neon-phal-plugin-linear-led/Config.in
```kconfig
config BR2_PACKAGE_PYTHON_NEON_PHAL_PLUGIN_LINEAR_LED
	bool "python-neon-phal-plugin-linear-led"
	help
	  PHAL Linear LED plugin

	  https://github.com/NeonGeckoCom/neon-phal-plugin-linear_led
```

## buildroot-external/package/python-neon-phal-plugin-switches/Config.in
```kconfig
config BR2_PACKAGE_PYTHON_NEON_PHAL_PLUGIN_SWITCHES
	bool "python-neon-phal-plugin-switches"
	help
	  PHAL Switches plugin

	  https://github.com/NeonGeckoCom/neon-phal-plugin-switches
```

## buildroot-external/package/python-neon-solver-plugin-ddg/Config.in
```kconfig
config BR2_PACKAGE_PYTHON_NEON_SOLVER_PLUGIN_DDG
	bool "python-neon-solver-plugin-ddg"
	help
	  neon solver plugin ddg

	  https://github.com/NeonGeckoCom/neon-solver-plugin-ddg
```

## buildroot-external/package/python-neon-solver-plugin-wikipedia/Config.in
```kconfig
config BR2_PACKAGE_PYTHON_NEON_SOLVER_PLUGIN_WIKIPEDIA
	bool "python-neon-solver-plugin-wikipedia"
	help
	  neon solver plugin wikipedia

	  https://github.com/NeonGeckoCom/neon-solver-plugin-wikipedia
```

## buildroot-external/package/python-neon-solver-plugin-wolfram-alpha/Config.in
```kconfig
config BR2_PACKAGE_PYTHON_NEON_SOLVER_PLUGIN_WOLFRAM_ALPHA
	bool "python-neon-solver-plugin-wolfram-alpha"
	help
	  neon solver plugin wolfram alpha

	  https://github.com/NeonGeckoCom/neon-solver-plugin-wolfram_alpha
```
