## buildroot-external/package/libgpiod2/Config.in
```kconfig
config BR2_PACKAGE_LIBGPIOD2
	bool "libgpiod2"
	depends on BR2_TOOLCHAIN_HEADERS_AT_LEAST_5_10
	depends on !BR2_PACKAGE_LIBGPIOD
	help
	  This is a C library that abstracts the GPIO character
	  device operations on linux.

	  https://git.kernel.org/pub/scm/libs/libgpiod/libgpiod.git/

	  This package is the continuation of the libgpiod package
	  for versions 2.0 and above.

	  Note that a kernel of 5.10 or above is required for the
	  ioctls to work.

if BR2_PACKAGE_LIBGPIOD2

config BR2_PACKAGE_LIBGPIOD2_TOOLS
	bool "install tools"
	help
	  Include a set of command-line tools for managing GPIOs.

endif

comment "Consider upgrading to libgpiod2"
	depends on BR2_PACKAGE_LIBGPIOD
```

## buildroot-external/package/libre/Config.in
```kconfig
config BR2_PACKAGE_LIBRE
	bool "libre"
	help
	  Toolkit library for asynchronous network 
	  IO with protocol stacks including SIP, SDP, 
	  RTP, STUN, TURN, ICE, BFCP and DNS.

	  http://www.creytiv.com/
```

## buildroot-external/package/librem/Config.in
```kconfig
config BR2_PACKAGE_LIBREM
	bool "librem"
	help
	  Toolkit library for real-time audio and video processing.

	  http://www.creytiv.com/
```

## buildroot-external/package/lottie-qml/Config.in
```kconfig
config BR2_PACKAGE_LOTTIE_QML
	bool "lottie-qml"
	help
	  This provides a QML Item to render Adobe® After Effects™ 
	  animations exported as JSON with Bodymovin using the Lottie 
	  Web library.

	  https://github.com/kbroulik/lottie-qml
```

## buildroot-external/package/mycroft-embedded-shell/Config.in
```kconfig
config BR2_PACKAGE_MYCROFT_EMBEDDED_SHELL
	bool "mycroft-embedded-shell"
	help
	  This is a mycroft gui app which is intended 
	  to run on low power hardware either as "single 
	  application" on a minimal wayland server or 
	  with eglfs backend.

	  https://github.com/notmart/mycroft-embedded-shell
```

## buildroot-external/package/mycroft-gui-embedded/Config.in
```kconfig
config BR2_PACKAGE_MYCROFT_GUI_EMBEDDED
	bool "mycroft-gui-embedded"
	help
	  The KDE-based visual interface for working with Mycroft
	  based on the Mark-2 version.
	  
	  https://github.com/MycroftAI/mycroft-gui-mark-2
```

## buildroot-external/package/mycroft-gui/Config.in
```kconfig
config BR2_PACKAGE_MYCROFT_GUI
	bool "mycroft-gui"
	help
	  The KDE-based visual interface for working with Mycroft.

	  https://github.com/MycroftAI/mycroft-gui
```

## buildroot-external/package/mycroft-mpd/Config.in
```kconfig
config BR2_PACKAGE_MYCROFT_MPD
	bool "mycroft-mpd"
	select BR2_PACKAGE_MPD
	select BR2_PACKAGE_MPD_BZIP2
	select BR2_PACKAGE_MPD_SQLITE
	select BR2_PACKAGE_MPD_LIBSAMPLERATE
	select BR2_PACKAGE_MPD_LIBSOXR
	select BR2_PACKAGE_MPD_AUDIOFILE
	select BR2_PACKAGE_MPD_FAAD2
	select BR2_PACKAGE_MPD_FLAC
	select BR2_PACKAGE_MPD_OPUS
	select BR2_PACKAGE_MPD_VORBIS
	select BR2_PACKAGE_MPD_CURL
	select BR2_PACKAGE_MPD_LIBNFS
	select BR2_PACKAGE_MPD_LIBSMBCLIENT
	select BR2_PACKAGE_MPD_SOUNDCLOUD
	select BR2_PACKAGE_MPD_AVAHI_SUPPORT
	select BR2_PACKAGE_MPD_NEIGHBOR_DISCOVERY_SUPPORT
	select BR2_PACKAGE_MPD_UPNP
	select BR2_PACKAGE_NCMPC
	help
	  Helper package that selects MPD and several codecs.
```

## buildroot-external/package/mycroft-service/Config.in
```kconfig
config BR2_PACKAGE_MYCROFT_SERVICE
	bool "mycroft-service"
	help
	  Start the Mycroft A.I. software as service.

	  https://mycroft.ai/
```

## buildroot-external/package/mycroft-skill-alarm/Config.in
```kconfig
config BR2_PACKAGE_MYCROFT_SKILL_ALARM
	bool "mycroft-skill-alarm"
	help
	  Mycroft AI official Alarm Skill - Set single 
	  and recurring alarms, with a choice of alarm sounds

	  https://github.com/MycroftAI/skill-alarm
```

## buildroot-external/package/mycroft-skill-audio-record/Config.in
```kconfig
config BR2_PACKAGE_MYCROFT_SKILL_AUDIO_RECORD
	bool "mycroft-skill-audio-record"
	help
	  Mycroft AI official Audio Record Skill - 
	  record audio and play it back

	  https://github.com/MycroftAI/skill-audio-record
```

## buildroot-external/package/mycroft-skill-balena-wifi-setup/Config.in
```kconfig
config BR2_PACKAGE_MYCROFT_SKILL_BALENA_WIFI_SETUP
	bool "mycroft-skill-balena-wifi-setup"
	help
	  Mycroft AI - OVOS WiFI Setup Skill
	  Provides the audio and visual elements for Connecting 
	  to Wifi via a secondary mobile device or computer.

	  https://github.com/OpenVoiceOS/skill-balena-wifi-setup
```

## buildroot-external/package/mycroft-skill-better-playback-control/Config.in
```kconfig
config BR2_PACKAGE_MYCROFT_SKILL_BETTER_PLAYBACK_CONTROL
	bool "mycroft-skill-better-playback-control"
	help
	  Better Common playback control system
	  NOTE: this is meant a better alternative to the 
	  official playback control skill 

	  https://github.com/JarbasSkills/skill-better-playback-control
```

## buildroot-external/package/mycroft-skill-better-stop/Config.in
```kconfig
config BR2_PACKAGE_MYCROFT_SKILL_BETTER_STOP
	bool "mycroft-skill-better-stop"
	help
	  Provides verbal interfaces for basic framework 
	  interactions, such as the "Stop" command. 

	  https://github.com/JarbasSkills/skill-better-stop
```

## buildroot-external/package/mycroft-skill-camera/Config.in
```kconfig
config BR2_PACKAGE_MYCROFT_SKILL_CAMERA
	bool "mycroft-skill-camera"
	help
	  Mycroft AI official camera Skill - Take 
	  singleshot photographs with the Camera Skill.

	  https://github.com/MycroftAI/skill-camera
```

## buildroot-external/package/mycroft-skill-configuration/Config.in
```kconfig
config BR2_PACKAGE_MYCROFT_SKILL_CONFIGURATION
	bool "mycroft-skill-configuration"
	help
	  User and device settings from home.mycroft.ai 
	  are synchronized with your Devices. This Skill 
	  performs that synchronization and allows you 
	  to check your settings.

	  https://github.com/MycroftAI/skill-configuration
```

## buildroot-external/package/mycroft-skill-date-time/Config.in
```kconfig
config BR2_PACKAGE_MYCROFT_SKILL_DATE_TIME
	bool "mycroft-skill-date-time"
	help
	  Mycroft AI official Date and Time Skill, providing 
	  the current time, date and day of week for cities 
	  around the world.

	  https://github.com/MycroftAI/skill-date-time
```

## buildroot-external/package/mycroft-skill-ddg/Config.in
```kconfig
config BR2_PACKAGE_MYCROFT_SKILL_DDG
	bool "mycroft-skill-ddg"
	help
	  Use DuckDuckGo to answer questions 

	  https://github.com/JarbasSkills/skill-ddg
```

## buildroot-external/package/mycroft-skill-installer/Config.in
```kconfig
config BR2_PACKAGE_MYCROFT_SKILL_INSTALLER
	bool "mycroft-skill-installer"
	help
	  Add and remove Mycroft Skills

	  https://github.com/MycroftAI/skill-installer
```

## buildroot-external/package/mycroft-skill-ip/Config.in
```kconfig
config BR2_PACKAGE_MYCROFT_SKILL_IP
	bool "mycroft-skill-ip"
	help
	  Network connection information

	  https://github.com/MycroftAI/skill-ip
```

## buildroot-external/package/mycroft-skill-joke/Config.in
```kconfig
config BR2_PACKAGE_MYCROFT_SKILL_JOKE
	bool "mycroft-skill-joke"
	help
	  Let Mycroft brighten your day with a little humor

	  https://github.com/MycroftAI/skill-joke
```

## buildroot-external/package/mycroft-skill-naptime/Config.in
```kconfig
config BR2_PACKAGE_MYCROFT_SKILL_NAPTIME
	bool "mycroft-skill-naptime"
	help
	  Tell Mycroft to sleep when you don't want 
	  to be disturbed in any way. This stops all 
	  calls to Speech to Text system, guaranteeing 
	  your voice won't be sent anywhere on an 
	  accidental activation.

	  https://github.com/MycroftAI/skill-naptime
```

## buildroot-external/package/mycroft-skill-osm/Config.in
```kconfig
config BR2_PACKAGE_MYCROFT_SKILL_OSM
	bool "mycroft-skill-osm"
	help
	  OpenVoiceOS Skill Manager GUI Installer Skill

	  https://github.com/OpenVoiceOS/skill-osm
```

## buildroot-external/package/mycroft-skill-ovos-alarm/Config.in
```kconfig
config BR2_PACKAGE_MYCROFT_SKILL_OVOS_ALARM
	bool "mycroft-skill-ovos-alarm"
	help
	  OVOS Alarm Skill - Set single 
	  and recurring alarms, with a choice of alarm sounds

	  https://github.com/OpenVoiceOS/skill-ovos-alarm
```

## buildroot-external/package/mycroft-skill-ovos-common-play/Config.in
```kconfig
config BR2_PACKAGE_MYCROFT_SKILL_OVOS_COMMON_PLAY
	bool "mycroft-skill-ovos-common-play"
	help
	  OVOS Common playback control system
	  NOTE: this is meant a better alternative to the 
	  official playback control skill 

	  https://github.com/OpenVoiceOS/skill-ovos-common-play
```
