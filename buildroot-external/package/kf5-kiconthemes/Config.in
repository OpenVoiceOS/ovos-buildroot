## buildroot-external/package/kf5-kio/Config.in
```kconfig
config BR2_PACKAGE_KF5_KIO
	bool "kf5-kio"
	select BR2_PACKAGE_KF5_KSERVICE
	select BR2_PACKAGE_KF5_SOLID
	select BR2_PACKAGE_KF5_KJOBWIDGETS
	select BR2_PACKAGE_KF5_KTEXTWIDGETS
```

## buildroot-external/package/kf5-kitemviews/Config.in
```kconfig
config BR2_PACKAGE_KF5_KITEMVIEWS
	bool "kf5-kitemviews"
	select BR2_PACKAGE_KF5_KICONTHEMES
```

## buildroot-external/package/kf5-ktextwidgets/Config.in
```kconfig
config BR2_PACKAGE_KF5_KTEXTWIDGETS
	bool "kf5-ktextwidgets"
	select BR2_PACKAGE_KF5_SONNET
```
