## buildroot-external/package/kf5-kwin/Config.in
```kconfig
config BR2_PACKAGE_KF5_KWIN
	bool "kf5-kwin"
	select BR2_PACKAGE_QT5SENSORS
	select BR2_PACKAGE_KF5_PLASMA_FRAMEWORK
	select BR2_PACKAGE_KF5_KWAYLAND
	select BR2_PACKAGE_KF5_KWAYLAND_SERVER
	select BR2_PACKAGE_KF5_KIDLETIME
	select BR2_PACKAGE_KF5_KINIT
	select BR2_PACKAGE_KF5_KCMUTILS
	select BR2_PACKAGE_KF5_KNEWSTUFF
	select BR2_PACKAGE_KF5_ATTICA
	select BR2_PACKAGE_KF5_KDECORATION
	select BR2_PACKAGE_KF5_KSCREENLOCKER
```

## buildroot-external/package/kf5-kxmlgui/Config.in
```kconfig
config BR2_PACKAGE_KF5_KXMLGUI
	bool "kf5-kxmlgui"
	select BR2_PACKAGE_KF5_KITEMVIEWS
	select BR2_PACKAGE_KF5_KGLOBALACCEL
```

## buildroot-external/package/kf5-plasma-wayland-protocols/Config.in
```kconfig
config BR2_PACKAGE_KF5_PLASMA_WAYLAND_PROTOCOLS
	bool "kf5-plasma-wayland-protocols"
```

## buildroot-external/package/ksm-preload/Config.in
```kconfig
config BR2_PACKAGE_KSM_PRELOAD
	bool "ksm-preload"
	help
	  Enables legacy applications to leverage Linux's memory deduplication.

	  https://github.com/unbrice/ksm_preload
```

## buildroot-external/package/ksmtuned/Config.in
```kconfig
config BR2_PACKAGE_KSMTUNED
	bool "ksmtuned"
	help
	  Kernel Samepage Merging services, ksm and ksmtuned.

	  https://github.com/ksmtuned/ksmtuned
```

## buildroot-external/package/libcanberra/Config.in
```kconfig
config BR2_PACKAGE_LIBCANBERRA
	bool "libcanberra"
	select	BR2_PACKAGE_ALSA_LIB
	select	BR2_PACKAGE_LIBVORBIS
	help
	  Portable sound event library

	  http://0pointer.de/lennart/projects/libcanberra
```
