## buildroot-external/package/python-ovos-phal-plugin-notification-widgets/Config.in
```kconfig
config BR2_PACKAGE_PYTHON_OVOS_PHAL_PLUGIN_NOTIFICATION_WIDGETS
	bool "python-ovos-phal-plugin-notification-widgets"
	help
	  Notifications and Widgets PHAL plugin

	  https://github.com/OpenVoiceOS/ovos-PHAL-plugin-notification-widgets
```

## buildroot-external/package/python-ovos-phal-plugin-oauth/Config.in
```kconfig
config BR2_PACKAGE_PYTHON_OVOS_PHAL_PLUGIN_OAUTH
	bool "python-ovos-phal-plugin-oauth"
	help
	  PHAL OAuth Plugin

	  https://github.com/OpenVoiceOS/ovos-PHAL-plugin-oauth
```

## buildroot-external/package/python-ovos-phal-plugin-respeaker-2mic/Config.in
```kconfig
config BR2_PACKAGE_PYTHON_OVOS_PHAL_PLUGIN_RESPEAKER_2MIC
	bool "python-ovos-phal-plugin-respeaker-2mic"
	help
	  OVOS-PHAL ReSpeaker 2mic

	  https://github.com/OpenVoiceOS/ovos-PHAL-plugin-respeaker-2mic
```

## buildroot-external/package/python-ovos-phal-plugin-respeaker-4mic/Config.in
```kconfig
config BR2_PACKAGE_PYTHON_OVOS_PHAL_PLUGIN_RESPEAKER_4MIC
	bool "python-ovos-phal-plugin-respeaker-4mic"
	help
	  OVOS-PHAL ReSpeaker 4mic

	  https://github.com/OpenVoiceOS/ovos-PHAL-plugin-respeaker-4mic
```

## buildroot-external/package/python-ovos-phal-plugin-system/Config.in
```kconfig
config BR2_PACKAGE_PYTHON_OVOS_PHAL_PLUGIN_SYSTEM
	bool "python-ovos-phal-plugin-system"
	help
	  OVOS-PHAL System events

	  https://github.com/OpenVoiceOS/ovos-PHAL-plugin-system
```

## buildroot-external/package/python-ovos-phal-plugin-wifi-setup/Config.in
```kconfig
config BR2_PACKAGE_PYTHON_OVOS_PHAL_PLUGIN_WIFI_SETUP
	bool "python-ovos-phal-plugin-wifi-setup"
	help
	  Central Wifi Setup Plugin for PHAL

	  https://github.com/OpenVoiceOS/ovos-PHAL-plugin-wifi-setup
```

## buildroot-external/package/python-ovos-phal/Config.in
```kconfig
config BR2_PACKAGE_PYTHON_OVOS_PHAL
	bool "python-ovos-phal"
	help
	  OVOS-PHAL 

	  https://github.com/OpenVoiceOS/ovos_PHAL
```

## buildroot-external/package/python-ovos-plugin-manager/Config.in
```kconfig
config BR2_PACKAGE_PYTHON_OVOS_PLUGIN_MANAGER
	bool "python-ovos-plugin-manager"
	select BR2_PACKAGE_PYTHON_OVOS_UTILS
	select BR2_PACKAGE_PYTHON_OVOS_BUS_CLIENT
	select BR2_PACKAGE_PYTHON_OVOS_CONFIG
	select BR2_PACKAGE_PYTHON_COMBO_LOCK
	select BR2_PACKAGE_PYTHON_REQUESTS
	select BR2_PACKAGE_PYTHON_QUEBRA_FRASES
	select BR2_PACKAGE_PYTHON_LANGCODES
	select BR2_PACKAGE_PYTHON_IMPORTLIB_METADATA
	select BR2_PACKAGE_PYTHON_SETUPTOOLS
	help
	  OPM can be used to search, install, load 
	  and create plugins for the OpenVoiceOS ecosystem!

	  https://github.com/OpenVoiceOS/OVOS-plugin-manager
```

## buildroot-external/package/python-ovos-skill-installer/Config.in
```kconfig
config BR2_PACKAGE_PYTHON_OVOS_SKILL_INSTALLER
	bool "python-ovos-skill-installer"
	help
	  Skills can be installed from github branches or 
	  releases, from .zip or .tar.gz urls

	  This tool is meant to be used internally by 
	  ovos_skills_manager, as an end user your probably 
	  should be using that and not this repository directly.

	  https://github.com/OpenVoiceOS/ovos_skill_installer
```

## buildroot-external/package/python-ovos-skill-manager/Config.in
```kconfig
config BR2_PACKAGE_PYTHON_OVOS_SKILL_MANAGER
	bool "python-ovos-skill-manager"
	help
	  Skill installer for OVOS. Install skills from any appstore!
	  
	  The mycroft-skills-manager alternative that is not vendor locked, 
	  this means you must use it responsibly!

	  Do not install random skills, different appstores have 
	  different policies!

	  https://github.com/OpenVoiceOS/ovos_skill_manager
```

## buildroot-external/package/python-ovos-stt-http-server/Config.in
```kconfig
config BR2_PACKAGE_PYTHON_OVOS_STT_HTTP_SERVER
	bool "python-ovos-stt-http-server"
	help
	  Turn any OVOS STT plugin into a micro service

	  https://github.com/OpenVoiceOS/ovos-stt-http-server
```

## buildroot-external/package/python-ovos-stt-plugin-chromium/Config.in
```kconfig
config BR2_PACKAGE_PYTHON_OVOS_STT_PLUGIN_CHROMIUM
	bool "python-ovos-stt-plugin-chromium"
	select BR2_PACKAGE_PYTHON_REQUESTS # runtime
	help
	  A stt plugin for mycroft using the google chrome browser
	  api.

	  https://github.com/OpenVoiceOS/ovos-stt-plugin-chromium
```

## buildroot-external/package/python-ovos-stt-plugin-pocketsphinx/Config.in
```kconfig
config BR2_PACKAGE_PYTHON_OVOS_STT_PLUGIN_POCKETSPHINX
	bool "python-ovos-stt-plugin-pocketsphinx"
	help
	  OVOS STT plugin for PocketSphinx

	  https://github.com/OpenVoiceOS/ovos-stt-plugin-pocketsphinx
```

## buildroot-external/package/python-ovos-stt-plugin-selene/Config.in
```kconfig
config BR2_PACKAGE_PYTHON_OVOS_STT_PLUGIN_SELENE
	bool "python-ovos-stt-plugin-selene"
	help
	  OVOS STT plugin for Mycroft A.I. it's selene backend

	  https://github.com/OpenVoiceOS/ovos-stt-plugin-selene
```

## buildroot-external/package/python-ovos-stt-plugin-server/Config.in
```kconfig
config BR2_PACKAGE_PYTHON_OVOS_STT_PLUGIN_SERVER
	bool "python-ovos-stt-plugin-server"
	help
	  OpenVoiceOS companion plugin for OpenVoiceOS STT Server

	  https://github.com/OpenVoiceOS/ovos-stt-plugin-server
```

## buildroot-external/package/python-ovos-stt-plugin-vosk/Config.in
```kconfig
config BR2_PACKAGE_PYTHON_OVOS_STT_PLUGIN_VOSK
	bool "python-ovos-stt-plugin-vosk"
	help
	  OVOS STT plugin for Vosk

	  https://github.com/OpenVoiceOS/ovos-stt-plugin-vosk
```

## buildroot-external/package/python-ovos-stt-plugin-whispercpp/Config.in
```kconfig
config BR2_PACKAGE_PYTHON_OVOS_STT_PLUGIN_WHISPERCPP
	bool "python-ovos-stt-plugin-whispercpp"
	help
	  OVOS STT plugin for whispercpp

	  https://github.com/OpenVoiceOS/ovos-stt-plugin-whispercpp
```

## buildroot-external/package/python-ovos-stt-server-plugin/Config.in
```kconfig
config BR2_PACKAGE_PYTHON_OVOS_STT_SERVER_PLUGIN
	bool "python-ovos-stt-server-plugin"
	help
	  OpenVoiceOS companion plugin for OpenVoiceOS STT Server

	  https://github.com/OpenVoiceOS/ovos-stt-server-plugin
```

## buildroot-external/package/python-ovos-tts-plugin-marytts/Config.in
```kconfig
config BR2_PACKAGE_PYTHON_OVOS_TTS_PLUGIN_MARYTTS
	bool "python-ovos-tts-plugin-marytts"
	help
	  TTS Plugin for MaryTTS

	  https://github.com/OpenVoiceOS/ovos-tts-plugin-marytts
```

## buildroot-external/package/python-ovos-tts-plugin-mimic/Config.in
```kconfig
config BR2_PACKAGE_PYTHON_OVOS_TTS_PLUGIN_MIMIC
	bool "python-ovos-tts-plugin-mimic"
	help
	  OVOS TTS plugin for Mimic

	  https://github.com/OpenVoiceOS/ovos-tts-plugin-mimic
```

## buildroot-external/package/python-ovos-tts-plugin-mimic2/Config.in
```kconfig
config BR2_PACKAGE_PYTHON_OVOS_TTS_PLUGIN_MIMIC2
	bool "python-ovos-tts-plugin-mimic2"
	help
	  OVOS TTS plugin for Mimic2

	  https://github.com/OpenVoiceOS/ovos-tts-plugin-mimic2
```

## buildroot-external/package/python-ovos-tts-plugin-mimic3-server/Config.in
```kconfig
config BR2_PACKAGE_PYTHON_OVOS_TTS_PLUGIN_MIMIC3_SERVER
	bool "python-ovos-tts-plugin-mimic3-server"
	help
	  OVOS Server TTS plugin for Mimic3

	  https://github.com/OpenVoiceOS/ovos-tts-plugin-mimic3-server
```

## buildroot-external/package/python-ovos-tts-plugin-pico/Config.in
```kconfig
config BR2_PACKAGE_PYTHON_OVOS_TTS_PLUGIN_PICO
	bool "python-ovos-tts-plugin-pico"
	help
	  OVOS TTS plugin for PicoTTS

	  https://github.com/OpenVoiceOS/ovos-tts-plugin-pico
```

## buildroot-external/package/python-ovos-tts-server-plugin/Config.in
```kconfig
config BR2_PACKAGE_PYTHON_OVOS_TTS_SERVER_PLUGIN
	bool "python-ovos-tts-server-plugin"
	help
	  OpenVoiceOS companion plugin for OpenVoiceOS TTS Server

	  https://github.com/OpenVoiceOS/ovos-tts-server-plugin
```

## buildroot-external/package/python-ovos-tts-server/Config.in
```kconfig
config BR2_PACKAGE_PYTHON_OVOS_TTS_SERVER
	bool "python-ovos-tts-server"
	help
	  Turn any OVOS TTS plugin into a micro service

	  https://github.com/OpenVoiceOS/ovos-tts-server
```
