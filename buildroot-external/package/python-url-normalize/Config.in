## buildroot-external/package/python-url-normalize/Config.in
```kconfig
config BR2_PACKAGE_PYTHON_URL_NORMALIZE
	bool "python-url-normalize"
	select BR2_PACKAGE_PYTHON_SIX # runtime
	help
	  URL normalization for Python.

	  https://github.com/niksite/url-normalize
```

## buildroot-external/package/python-user-agents/Config.in
```kconfig
config BR2_PACKAGE_PYTHON_USER_AGENTS
	bool "python-user-agents"
	select BR2_PACKAGE_PYTHON_UA_PARSER # runtime
	help
	  A library to identify devices (phones, tablets) and their
	  capabilities by parsing browser user agent strings.

	  https://github.com/selwin/python-user-agents
```

## buildroot-external/package/python-vlc/Config.in
```kconfig
config BR2_PACKAGE_PYTHON_VLC
	bool "python-vlc"
	help
	  VLC bindings for python.

	  http://wiki.videolan.org/PythonBinding
```

## buildroot-external/package/python-vosk-api/Config.in
```kconfig
config BR2_PACKAGE_PYTHON_VOSK_API
	bool "python-vosk-api"
	select BR2_PACKAGE_PYTHON_CFFI
	select BR2_PACKAGE_PYTHON_TQDM
	select BR2_PACKAGE_PYTHON_REQUESTS
	select BR2_PACKAGE_PYTHON_SRT
	select BR2_PACKAGE_PYTHON_WEBSOCKETS
	select BR2_PACKAGE_VOSK_API
	help
	  Offline speech recognition API for Android, iOS, 
	  Raspberry Pi and servers with Python, Java, C# 
	  and Node.

	  https://github.com/alphacep/vosk-api.git
```

## buildroot-external/package/python-webcolors/Config.in
```kconfig
config BR2_PACKAGE_PYTHON_WEBCOLORS
	bool "python-webcolors"
	help
	  webcolors is a module for working with 
	  HTML/CSS color definitions.

	  https://github.com/ubernostrum/webcolors
```

## buildroot-external/package/python-webrtcvad/Config.in
```kconfig
config BR2_PACKAGE_PYTHON_WEBRTCVAD
	bool "python-webrtcvad"
	help
	  This is a python interface to the 
	  WebRTC Voice Activity Detector (VAD).

	  https://pypi.org/project/webrtcvad/
```

## buildroot-external/package/python-wheel/Config.in
```kconfig
config BR2_PACKAGE_PYTHON_WHEEL
	bool "python-wheel"
	help
	  This library is the reference implementation 
	  of the Python wheel packaging standard, as 
	  defined in PEP 427.

	  https://github.com/pypa/wheel
```

## buildroot-external/package/python-wikipedia-api/Config.in
```kconfig
config BR2_PACKAGE_PYTHON_WIKIPEDIA_API
	bool "python-wikipedia-api"
	select BR2_PACKAGE_PYTHON_REQUESTS # runtime
	help
	  Python Wrapper for Wikipedia.

	  https://github.com/martin-majlis/Wikipedia-API
```

## buildroot-external/package/python-wikipedia-for-humans/Config.in
```kconfig
config BR2_PACKAGE_PYTHON_WIKIPEDIA_FOR_HUMANS
	bool "python-wikipedia-for-humans"
	select BR2_PACKAGE_PYTHON_INFLECTION # runtime
	select BR2_PACKAGE_PYTHON_QUEBRA_FRASES # runtime
	select BR2_PACKAGE_PYTHON_REQUESTS # runtime
	select BR2_PACKAGE_PYTHON_WIKIPEDIA_API # runtime
	help
	  wikipedia for humans.

	  https://github.com/OpenJarbas/wikipedia_for_humans
```

## buildroot-external/package/python-xmlrunner/Config.in
```kconfig
config BR2_PACKAGE_PYTHON_XMLRUNNER
	bool "python-xmlrunner"
	help
	  PyUnit-based test runner with JUnit like XML reporting.

	  https://github.com/pycontribs/xmlrunner
```

## buildroot-external/package/python-xxhash/Config.in
```kconfig
config BR2_PACKAGE_PYTHON_XXHASH
	bool "python-xxhash"
	help
	  Python binding for xxHash.

	  https://github.com/ifduyue/python-xxhash
```

## buildroot-external/package/python-yagmail/Config.in
```kconfig
config BR2_PACKAGE_PYTHON_YAGMAIL
	bool "python-yagmail"
	select BR2_PACKAGE_PYTHON_PREMAILER # runtime
	help
	  Yet Another GMAIL client.

	  https://github.com/kootenpv/yagmail
```

## buildroot-external/package/python-youtube-searcher/Config.in
```kconfig
config BR2_PACKAGE_PYTHON_YOUTUBE_SEARCHER
	bool "python-youtube-searcher"
	select BR2_PACKAGE_PYTHON_BS4 # runtime
	select BR2_PACKAGE_PYTHON_REQUESTS # runtime
	select BR2_PACKAGE_PYTHON_REQUESTS_CACHE # runtime
	help
	  search youtube.

	  https://github.com/HelloChatterbox/youtube_searcher
```

## buildroot-external/package/python-yt-dlp/Config.in
```kconfig
config BR2_PACKAGE_PYTHON_YT_DLP
	bool "python-yt-dlp"
	select BR2_PACKAGE_PYTHON_MUTAGEN # runtime
	select BR2_PACKAGE_PYTHON_PYCRYPTODOMEX # runtime
	select BR2_PACKAGE_PYTHON_WEBSOCKETS # runtime
	help
	  A youtube-dl fork with additional features and patches.

	  https://github.com/yt-dlp/yt-dlp
```

## buildroot-external/package/python-ytmusicapi/Config.in
```kconfig
config BR2_PACKAGE_PYTHON_YTMUSICAPI
	bool "python-ytmusicapi"
	select BR2_PACKAGE_PYTHON_REQUESTS # runtime
	help
	  Unofficial API for YouTube Music.

	  https://github.com/sigma67/ytmusicapi
```

## buildroot-external/package/python-zipp/Config.in
```kconfig
config BR2_PACKAGE_PYTHON_ZIPP
	bool "python-zipp"
	help
	  A pathlib-compatible Zipfile object wrapper.
	  Official backport of the standard library 
	  Path object.

	  https://github.com/jaraco/zipp
```

## buildroot-external/package/qmltermwidget/Config.in
```kconfig
config BR2_PACKAGE_QMLTERMWIDGET
	bool "qmltermwidget"
	help
	  QML port of qtermwidget

	  https://github.com/Swordfish90/qmltermwidget
```

## buildroot-external/package/qt5ct/Config.in
```kconfig
config BR2_PACKAGE_QT5CT
	bool "qt5ct"
	help
	  Qt5 Configuration Tool

	  https://sourceforge.net/projects/qt5ct/
```

## buildroot-external/package/qtav/Config.in
```kconfig
config BR2_PACKAGE_QTAV
	bool "qtav"
	help
	  QtAV is a multimedia playback library based on Qt 
	  and FFmpeg. It can help you to write a player with 
	  less effort than ever before.

	  https://github.com/balabit/QtAV
```

## buildroot-external/package/respeaker/Config.in
```kconfig
config BR2_PACKAGE_RESPEAKER
	bool "respeaker"
	select BR2_PACKAGE_RPI_USERLAND
	select BR2_PACKAGE_DTC
	help
	  The ReSpeaker series is a family of 
	  development boards designed to enable 
	  a future where voice interface is part 
	  of everyday human-device interaction. 
	  Designed to be easily integrated (and 
	  customized) into products, but also to 
	  allow other services and products to be 
	  easily integrated into it.

	  https://respeaker.io/
```

## buildroot-external/package/rnnnoise-ladspa/Config.in
```kconfig
config BR2_PACKAGE_RNNNOISE_LADSPA
	bool "rnnnoise-ladspa"
	help
	  Noise suppression plugin based on Xiph's RNNoise

	  https://github.com/werman/noise-suppression-for-voice
```

## buildroot-external/package/roc-toolkit/Config.in
```kconfig
config BR2_PACKAGE_ROC_TOOLKIT
	bool "roc-toolkit"
	select BR2_PACKAGE_GST1_LIBAV
	select BR2_PACKAGE_LIBUNWIND
	select BR2_PACKAGE_OPENFEC
	select BR2_PACKAGE_SPEEXDSP
	help
	  Roc is a toolkit for real-time audio streaming over the network.

	  https://github.com/roc-streaming/roc-toolkit
```

## buildroot-external/package/ruy/Config.in
```kconfig
config BR2_PACKAGE_RUY
	bool "ruy"
	depends on BR2_INSTALL_LIBSTDCPP
        select BR2_PACKAGE_CPUINFO
	help
	  ruy is a matrix multiplication library. 
	  Its focus is to cover the matrix multiplication 
	  needs of neural network inference engines. 

	  Its initial user has been TensorFlow Lite, where 
	  it is used by default on the ARM CPU architecture.

	  https://github.com/google/ruy
```

## buildroot-external/package/skill-alerts/Config.in
```kconfig
config BR2_PACKAGE_SKILL_ALERTS
	bool "skill-alerts"
	help
	  A skill to schedule alarms, timers, and reminders

	  https://github.com/OpenVoiceOS/skill-alerts
```

## buildroot-external/package/skill-camera/Config.in
```kconfig
config BR2_PACKAGE_SKILL_CAMERA
	bool "skill-camera"
	help
	  OVOS official camera Skill - Take 
	  singleshot photographs with the Camera Skill.

	  https://github.com/OpenVoiceOS/skill-camera
```
