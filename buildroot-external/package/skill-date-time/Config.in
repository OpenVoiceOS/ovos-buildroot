## buildroot-external/package/skill-date-time/Config.in
```kconfig
config BR2_PACKAGE_SKILL_DATE_TIME
	bool "skill-date-time"
	help
	  OVOS official Date and Time Skill, providing 
	  the current time, date and day of week for cities 
	  around the world.

	  https://github.com/OpenVoiceOS/skill-date-time
```

## buildroot-external/package/skill-ddg/Config.in
```kconfig
config BR2_PACKAGE_SKILL_DDG
	bool "skill-ddg"
	help
	  Use DuckDuckGo to answer questions 

	  https://github.com/JarbasSkills/skill-ddg
```

## buildroot-external/package/skill-local-music/Config.in
```kconfig
config BR2_PACKAGE_SKILL_LOCAL_MUSIC
	bool "skill-local-music"
	help
	  Neon Skill for Local Music Playback 

	  https://github.com/NeonGeckoCom/skill-local_music
```

## buildroot-external/package/skill-naptime/Config.in
```kconfig
config BR2_PACKAGE_SKILL_NAPTIME
	bool "skill-naptime"
	help
	  Tell me to sleep when you don't want 
	  to be disturbed in any way. This stops all 
	  calls to Speech to Text system, guaranteeing 
	  your voice won't be sent anywhere on an 
	  accidental activation.

	  https://github.com/OpenVoiceOS/ovos-skill-naptime
```

## buildroot-external/package/skill-news/Config.in
```kconfig
config BR2_PACKAGE_SKILL_NEWS
	bool "skill-news"
	help
	  News Streams from around the globe 

	  https://github.com/JarbasSkills/skill-news
```

## buildroot-external/package/skill-ovos-alarm/Config.in
```kconfig
config BR2_PACKAGE_SKILL_OVOS_ALARM
	bool "skill-ovos-alarm"
	help
	  OVOS Alarm Skill - Set single 
	  and recurring alarms, with a choice of alarm sounds

	  https://github.com/OpenVoiceOS/skill-ovos-alarm
```

## buildroot-external/package/skill-ovos-date-time/Config.in
```kconfig
config BR2_PACKAGE_SKILL_OVOS_DATE_TIME
	bool "skill-ovos-date-time"
	help
	  OVOS official Date and Time Skill, providing 
	  the current time, date and day of week for cities 
	  around the world.

	  https://github.com/OpenVoiceOS/skill-ovos-date-time
```

## buildroot-external/package/skill-ovos-ddg/Config.in
```kconfig
config BR2_PACKAGE_SKILL_OVOS_DDG
	bool "skill-ovos-ddg"
	help
	  Use DuckDuckGo to answer questions 

	  https://github.com/OpenVoiceOS/skill-ovos-ddg
```

## buildroot-external/package/skill-ovos-fallback-unknown/Config.in
```kconfig
config BR2_PACKAGE_SKILL_OVOS_FALLBACK_UNKNOWN
	bool "skill-ovos-fallback-unknown"
	help
	  Mycroft AI official Unknown Fallback Skill - 
	  used if no Intent is matched to an Utterance

	  https://github.com/OpenVoiceOS/ovos-skill-fallback-unknown
```

## buildroot-external/package/skill-ovos-filebrowser/Config.in
```kconfig
config BR2_PACKAGE_SKILL_OVOS_FILEBROWSER
	bool "skill-ovos-filebrowser"
	help
	  File Browser for OpenVoice OS Platform 

	  https://github.com/OpenVoiceOS/skill-ovos-filebrowser
```

## buildroot-external/package/skill-ovos-homescreen/Config.in
```kconfig
config BR2_PACKAGE_SKILL_OVOS_HOMESCREEN
	bool "skill-ovos-homescreen"
	help
	  OVOS Homescreen Skill
	  Provides custom resting face for OVOS

	  https://github.com/OpenVoiceOS/skill-ovos-homescreen
```

## buildroot-external/package/skill-ovos-info/Config.in
```kconfig
config BR2_PACKAGE_SKILL_OVOS_INFO
	bool "skill-ovos-info"
	help
	  Skill information parser support skill

	  https://github.com/OpenVoiceOS/ovos-skills-info
```

## buildroot-external/package/skill-ovos-news/Config.in
```kconfig
config BR2_PACKAGE_SKILL_OVOS_NEWS
	bool "skill-ovos-news"
	help
	  News Streams from around the globe 

	  https://github.com/OpenVoiceOS/skill-ovos-news
```

## buildroot-external/package/skill-ovos-notes/Config.in
```kconfig
config BR2_PACKAGE_SKILL_OVOS_NOTES
	bool "skill-ovos-notes"
	help
	  Take personal notes to keep track of appointments, 
	  to-do items, etc.

	  https://github.com/OpenVoiceOS/skill-ovos-notes
```

## buildroot-external/package/skill-ovos-personal/Config.in
```kconfig
config BR2_PACKAGE_SKILL_OVOS_PERSONAL
	bool "skill-ovos-personal"
	help
	  Learn history and personality of Mycroft

	  https://github.com/MycroftAI/skill-personal
```

## buildroot-external/package/skill-ovos-settings/Config.in
```kconfig
config BR2_PACKAGE_SKILL_OVOS_SETTINGS
	bool "skill-ovos-settings"
	help
	  Skill to take control of OpenVoiceOS functions 
	  via websettings interface

	  https://github.com/OpenVoiceOS/skill-ovos-settings
```

## buildroot-external/package/skill-ovos-setup/Config.in
```kconfig
config BR2_PACKAGE_SKILL_OVOS_SETUP
	bool "skill-ovos-setup"
	help
	  OVOS Setup Skill

	  https://github.com/OpenVoiceOS/skill-ovos-setup
```

## buildroot-external/package/skill-ovos-stop/Config.in
```kconfig
config BR2_PACKAGE_SKILL_OVOS_STOP
	bool "skill-ovos-stop"
	help
	  Provides verbal interfaces for basic framework 
	  interactions, such as the "Stop" command. 

	  https://github.com/OpenVoiceOS/skill-ovos-stop
```

## buildroot-external/package/skill-ovos-timer/Config.in
```kconfig
config BR2_PACKAGE_SKILL_OVOS_TIMER
	bool "skill-ovos-timer"
	help
	  Set named timers for cooking, watering 
	  plants, brewing tea and more.

	  https://github.com/OpenVoiceOS/skill-ovos-timer
```

## buildroot-external/package/skill-ovos-volume/Config.in
```kconfig
config BR2_PACKAGE_SKILL_OVOS_VOLUME
	bool "skill-ovos-volume"
	help
	  OVOS Volume Skill
	  Control the volume of your Device

	  https://github.com/OpenVoiceOS/skill-ovos-volume
```

## buildroot-external/package/skill-ovos-weather/Config.in
```kconfig
config BR2_PACKAGE_SKILL_OVOS_WEATHER
	bool "skill-ovos-weather"
	help
	  OpenVoiceOS version of Weather Skill, providing 
	  weather conditions and forecasts.

	  https://github.com/OpenVoiceOS/skill-weather
```

## buildroot-external/package/skill-ovos-wikipedia/Config.in
```kconfig
config BR2_PACKAGE_SKILL_OVOS_WIKIPEDIA
	bool "skill-ovos-wikipedia"
	help
	  Query Wikipedia for answers to all your questions. 
	  Get just a summary, or ask for more to get in-depth 
	  information.

	  https://github.com/OpenVoiceOS/skill-ovos-wikipedia
```

## buildroot-external/package/skill-ovos-wolfie/Config.in
```kconfig
config BR2_PACKAGE_SKILL_OVOS_WOLFIE
	bool "skill-ovos-wolfie"
	help
	  Use Wolfram Alpha for general knowledge questions 

	  https://github.com/OpenVoiceOS/skill-ovos-wolfie
```

## buildroot-external/package/skill-wolfie/Config.in
```kconfig
config BR2_PACKAGE_SKILL_WOLFIE
	bool "skill-wolfie"
	help
	  Use Wolfram Alpha for general knowledge questions 

	  https://github.com/OpenVoiceOS/skill-wolfie
```

## buildroot-external/package/skill-youtube-music/Config.in
```kconfig
config BR2_PACKAGE_SKILL_YOUTUBE_MUSIC
	bool "skill-youtube-music"
	help
	  play music from youtube in mycroft

	  https://github.com/JarbasSkills/skill-youtube-music
```
