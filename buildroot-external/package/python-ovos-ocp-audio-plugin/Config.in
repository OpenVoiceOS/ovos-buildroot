## buildroot-external/package/python-ovos-ocp-audio-plugin/Config.in
```kconfig
config BR2_PACKAGE_PYTHON_OVOS_OCP_AUDIO_PLUGIN
	bool "python-ovos-ocp-audio-plugin"
	help
	  OVOS GUI mediaplayer plugin

	  https://github.com/OpenVoiceOS/ovos-ocp-audio-plugin
```

## buildroot-external/package/python-ovos-ocp-bandcamp-plugin/Config.in
```kconfig
config BR2_PACKAGE_PYTHON_OVOS_OCP_BANDCAMP_PLUGIN
	bool "python-ovos-ocp-bandcamp-plugin"
	help
	  
	  https://github.com/OpenVoiceOS/ovos-ocp-bandcamp-plugin
```

## buildroot-external/package/python-ovos-ocp-deezer-plugin/Config.in
```kconfig
config BR2_PACKAGE_PYTHON_OVOS_OCP_DEEZER_PLUGIN
	bool "python-ovos-ocp-deezer-plugin"
	help
	  
	  https://github.com/OpenVoiceOS/ovos-ocp-deezer-plugin
```

## buildroot-external/package/python-ovos-ocp-files-plugin/Config.in
```kconfig
config BR2_PACKAGE_PYTHON_OVOS_OCP_FILES_PLUGIN
	bool "python-ovos-ocp-files-plugin"
	help
	  A library for reading and, in the future, writing audio metadata.

	  https://github.com/OpenVoiceOS/ovos-ocp-files-plugin
```

## buildroot-external/package/python-ovos-ocp-m3u-plugin/Config.in
```kconfig
config BR2_PACKAGE_PYTHON_OVOS_OCP_M3U_PLUGIN
	bool "python-ovos-ocp-m3u-plugin"
	help
	  
	  https://github.com/OpenVoiceOS/ovos-ocp-m3u-plugin
```

## buildroot-external/package/python-ovos-ocp-news-plugin/Config.in
```kconfig
config BR2_PACKAGE_PYTHON_OVOS_OCP_NEWS_PLUGIN
	bool "python-ovos-ocp-news-plugin"
	help
	  
	  https://github.com/OpenVoiceOS/ovos-ocp-news-plugin
```

## buildroot-external/package/python-ovos-ocp-rss-plugin/Config.in
```kconfig
config BR2_PACKAGE_PYTHON_OVOS_OCP_RSS_PLUGIN
	bool "python-ovos-ocp-rss-plugin"
	help
	  
	  https://github.com/OpenVoiceOS/ovos-ocp-rss-plugin
```

## buildroot-external/package/python-ovos-ocp-youtube-plugin/Config.in
```kconfig
config BR2_PACKAGE_PYTHON_OVOS_OCP_YOUTUBE_PLUGIN
	bool "python-ovos-ocp-youtube-plugin"
	help
	  
	  https://github.com/OpenVoiceOS/ovos-ocp-youtube-plugin
```

## buildroot-external/package/python-ovos-personal-backend/Config.in
```kconfig
config BR2_PACKAGE_PYTHON_OVOS_PERSONAL_BACKEND
	bool "python-ovos-personal-backend"
	select BR2_PACKAGE_PYTHON_FLASK # runtime
	select BR2_PACKAGE_PYTHON_FLASK_MAIL # runtime
	select BR2_PACKAGE_PYTHON_GEOCODER # runtime
	select BR2_PACKAGE_PYTHON_JSON_DATABASE # runtime
	select BR2_PACKAGE_PYTHON_PYOPENSSL # runtime
	select BR2_PACKAGE_PYTHON_REQUESTS # runtime
	select BR2_PACKAGE_PYTHON_SPEECH2TEXT # runtime
	select BR2_PACKAGE_PYTHON_TIMEZONEFINDER # runtime
	help
	  Personal mycroft backend alternative to mycroft.home, 
	  written in flask

	  https://github.com/OpenVoiceOS/ovos-personal-backend
```

## buildroot-external/package/python-ovos-phal-plugin-alsa/Config.in
```kconfig
config BR2_PACKAGE_PYTHON_OVOS_PHAL_PLUGIN_ALSA
	bool "python-ovos-phal-plugin-alsa"
	help
	  OVOS-PHAL Alsa volume control

	  https://github.com/OpenVoiceOS/ovos-PHAL-plugin-alsa
```

## buildroot-external/package/python-ovos-phal-plugin-balena-wifi/Config.in
```kconfig
config BR2_PACKAGE_PYTHON_OVOS_PHAL_PLUGIN_BALENA_WIFI
	bool "python-ovos-phal-plugin-balena-wifi"
	help
	  OVOS-PHAL Balena WIFI setup

	  https://github.com/OpenVoiceOS/ovos-PHAL-plugin-balena-wifi
```

## buildroot-external/package/python-ovos-phal-plugin-brightness-control-rpi/Config.in
```kconfig
config BR2_PACKAGE_PYTHON_OVOS_PHAL_PLUGIN_BRIGHTNESS_CONTROL_RPI
	bool "python-ovos-phal-plugin-brightness-control-rpi"
	help
	  OVOS PHAL BRIGHTNESS CONTROL PLUGIN FOR RPI

	  https://github.com/OpenVoiceOS/ovos-PHAL-plugin-brightness-control-rpi
```

## buildroot-external/package/python-ovos-phal-plugin-color-scheme-manager/Config.in
```kconfig
config BR2_PACKAGE_PYTHON_OVOS_PHAL_PLUGIN_COLOR_SCHEME_MANAGER
	bool "python-ovos-phal-plugin-color-scheme-manager"
	help
	  OVOS Shell ColorScheme Manager Plugin for OVOS PHAL

	  https://github.com/OpenVoiceOS/ovos-PHAL-plugin-color-scheme-manager
```

## buildroot-external/package/python-ovos-phal-plugin-configuration-provider/Config.in
```kconfig
config BR2_PACKAGE_PYTHON_OVOS_PHAL_PLUGIN_CONFIGURATION_PROVIDER
	bool "python-ovos-phal-plugin-configuration-provider"
	help
	  PHAL plugin to provide configuration in displayable GUI format

	  https://github.com/OpenVoiceOS/ovos-PHAL-plugin-configuration-provider
```

## buildroot-external/package/python-ovos-phal-plugin-connectivity-events/Config.in
```kconfig
config BR2_PACKAGE_PYTHON_OVOS_PHAL_PLUGIN_CONNECTIVITY_EVENTS
	bool "python-ovos-phal-plugin-connectivity-events"
	help
	  OVOS-PHAL Connectivity Events

	  https://github.com/OpenVoiceOS/ovos-PHAL-plugin-connectivity-events
```

## buildroot-external/package/python-ovos-phal-plugin-dashboard/Config.in
```kconfig
config BR2_PACKAGE_PYTHON_OVOS_PHAL_PLUGIN_DASHBOARD
	bool "python-ovos-phal-plugin-dashboard"
	help
	  OVOS-PHAL Dashboard

	  https://github.com/OpenVoiceOS/ovos-PHAL-plugin-dashboard
```

## buildroot-external/package/python-ovos-phal-plugin-display-manager-ipc/Config.in
```kconfig
config BR2_PACKAGE_PYTHON_OVOS_PHAL_PLUGIN_DISPLAY_MANAGER_IPC
	bool "python-ovos-phal-plugin-display-manager-ipc"
	help
	  OVOS-PHAL Display Manager IPC

	  https://github.com/OpenVoiceOS/ovos-PHAL-plugin-display-manager-ipc
```

## buildroot-external/package/python-ovos-phal-plugin-gpsd/Config.in
```kconfig
config BR2_PACKAGE_PYTHON_OVOS_PHAL_PLUGIN_GPSD
	bool "python-ovos-phal-plugin-gpsd"
	help
	  OVOS-PHAL GPS Deamon

	  https://github.com/OpenVoiceOS/ovos-PHAL-plugin-gpsd
```

## buildroot-external/package/python-ovos-phal-plugin-gui-network-client/Config.in
```kconfig
config BR2_PACKAGE_PYTHON_OVOS_PHAL_PLUGIN_GUI_NETWORK_CLIENT
	bool "python-ovos-phal-plugin-gui-network-client"
	help
	  A GUI Network Client For PHAL

	  https://github.com/OpenVoiceOS/ovos-PHAL-plugin-gui-network-client
```

## buildroot-external/package/python-ovos-phal-plugin-homeassistant/Config.in
```kconfig
config BR2_PACKAGE_PYTHON_OVOS_PHAL_PLUGIN_HOMEASSISTANT
	bool "python-ovos-phal-plugin-homeassistant"
	help
	  HomeAssistant PHAL Plugin for OpenVoiceOS

	  https://github.com/OpenVoiceOS/ovos-PHAL-plugin-homeassistant
```

## buildroot-external/package/python-ovos-phal-plugin-ipc2bus/Config.in
```kconfig
config BR2_PACKAGE_PYTHON_OVOS_PHAL_PLUGIN_IPC2BUS
	bool "python-ovos-phal-plugin-ipc2bus"
	help
	  OVOS-PHAL IPC2Bus

	  https://github.com/OpenVoiceOS/ovos-PHAL-plugin-ipc2bus
```

## buildroot-external/package/python-ovos-phal-plugin-ipgeo/Config.in
```kconfig
config BR2_PACKAGE_PYTHON_OVOS_PHAL_PLUGIN_IPGEO
	bool "python-ovos-phal-plugin-ipgeo"
	help
	  OVOS-PHAL IP geolocation

	  https://github.com/OpenVoiceOS/ovos-PHAL-plugin-ipgeo
```

## buildroot-external/package/python-ovos-phal-plugin-mk1/Config.in
```kconfig
config BR2_PACKAGE_PYTHON_OVOS_PHAL_PLUGIN_MK1
	bool "python-ovos-phal-plugin-mk1"
	help
	  OVOS-PHAL Mark-1

	  https://github.com/OpenVoiceOS/ovos-PHAL-plugin-mk1
```

## buildroot-external/package/python-ovos-phal-plugin-mk2/Config.in
```kconfig
config BR2_PACKAGE_PYTHON_OVOS_PHAL_PLUGIN_MK2
	bool "python-ovos-phal-plugin-mk2"
	help
	  OVOS-PHAL Mark-2

	  https://github.com/OpenVoiceOS/ovos-PHAL-plugin-mk2
```

## buildroot-external/package/python-ovos-phal-plugin-network-manager/Config.in
```kconfig
config BR2_PACKAGE_PYTHON_OVOS_PHAL_PLUGIN_NETWORK_MANAGER
	bool "python-ovos-phal-plugin-network-manager"
	help
	  NetworkManager plugin for PHAL

	  https://github.com/OpenVoiceOS/ovos-PHAL-plugin-network-manager
```
