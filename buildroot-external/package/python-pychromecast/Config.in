## buildroot-external/package/python-pychromecast/Config.in
```kconfig
config BR2_PACKAGE_PYTHON_PYCHROMECAST
	bool "python-pychromecast"
	select BR2_PACKAGE_PYTHON_REQUESTS # runtime
	select BR2_PACKAGE_PYTHON_PROTOBUF # runtime
	select BR2_PACKAGE_PYTHON_ZEROCONF # runtime
	select BR2_PACKAGE_PYTHON_CASTTUBE # runtime
	help
	  Python module to talk to Google Chromecast.

	  https://github.com/balloob/pychromecast
```

## buildroot-external/package/python-pycpuinfo/Config.in
```kconfig
config BR2_PACKAGE_PYTHON_PYCPUINFO
	bool "python-pycpuinfo"
	help
	  Get CPU info with pure Python 2 & 3.

	  https://github.com/workhorsy/py-cpuinfo
```

## buildroot-external/package/python-pyee/Config.in
```kconfig
config BR2_PACKAGE_PYTHON_PYEE
	bool "python-pyee"
	help
	  A port of node.js's EventEmitter to python.

	  https://github.com/jfhbrook/pyee
```

## buildroot-external/package/python-pyftdi/Config.in
```kconfig
config BR2_PACKAGE_PYTHON_PYFTDI
	bool "python-pyftdi"
	select BR2_PACKAGE_PYTHON_PYSERIAL # runtime
	select BR2_PACKAGE_PYTHON_PYUSB # runtime
	help
	  FTDI device driver (pure Python).

	  http://github.com/eblot/pyftdi
```

## buildroot-external/package/python-pygithub/Config.in
```kconfig
config BR2_PACKAGE_PYTHON_PYGITHUB
	bool "python-pygithub"
	help
	  Use the full Github API v3

	  http://pygithub.readthedocs.io/en/latest/
```

## buildroot-external/package/python-pyjokes/Config.in
```kconfig
config BR2_PACKAGE_PYTHON_PYJOKES
	bool "python-pyjokes"
	help
	  One line jokes for programmers (jokes as a service).

	  https://pyjok.es/
```

## buildroot-external/package/python-pymeeus/Config.in
```kconfig
config BR2_PACKAGE_PYTHON_PYMEEUS
	bool "python-pymeeus"
	help
	  Python implementation of Jean Meeus astronomical routines.

	  https://github.com/architest/pymeeus
```

## buildroot-external/package/python-pymplayer/Config.in
```kconfig
config BR2_PACKAGE_PYTHON_PYMPLAYER
	bool "python-pymplayer"
	help
	  mplayer python api.

	  https://github.com/JarbasAl/py_mplayer
```

## buildroot-external/package/python-pyowm/Config.in
```kconfig
config BR2_PACKAGE_PYTHON_PYOWM
	bool "python-pyowm"
	help
	  PyOWM is a client Python wrapper library for the
	  OpenWeatherMap web API. It allows quick and easy 
	  consumption of OWM weather data from Python applications 
	  via a simple object model and in a human-friendly fashion.

	  http://github.com/csparpa/pyowm
```

## buildroot-external/package/python-pytest-runner/Config.in
```kconfig
config BR2_PACKAGE_PYTHON_PYTEST_RUNNER
        bool "python-pytest-runner"
        help
          Invoke py.test as distutils command with dependency
          resolution.

          https://github.com/pytest-dev/pytest-runner/
```

## buildroot-external/package/python-pythran/Config.in
```kconfig
config BR2_PACKAGE_PYTHON_PYTHRAN
	bool "python-pythran"
	select BR2_PACKAGE_PYTHON_BENIGET # runtime
	select BR2_PACKAGE_PYTHON_GAST # runtime
	select BR2_PACKAGE_PYTHON_NUMPY # runtime
	select BR2_PACKAGE_PYTHON_PLY # runtime
	help
	  Ahead of Time compiler for numeric kernels.

	  https://github.com/serge-sans-paille/pythran
```

## buildroot-external/package/python-pytube/Config.in
```kconfig
config BR2_PACKAGE_PYTHON_PYTUBE
	bool "python-pytube"
	help
	  Python 3 library for downloading YouTube Videos.

	  https://github.com/pytube/pytube
```

## buildroot-external/package/python-pytzdata/Config.in
```kconfig
config BR2_PACKAGE_PYTHON_PYTZDATA
	bool "python-pytzdata"
	help
	  The Olson timezone database for Python.

	  https://github.com/sdispater/pytzdata
```

## buildroot-external/package/python-pywebio/Config.in
```kconfig
config BR2_PACKAGE_PYTHON_PYWEBIO
	bool "python-pywebio"
	select BR2_PACKAGE_PYTHON_TORNADO # runtime
	select BR2_PACKAGE_PYTHON_USER_AGENTS # runtime
	help
	  Write interactive web app in script way.

	  https://pywebio.readthedocs.io
```

## buildroot-external/package/python-pyxdg/Config.in
```kconfig
config BR2_PACKAGE_PYTHON_PYXDG
	bool "python-pyxdg"
	help
	  PyXDG is a python library to access freedesktop.org standards..

	  https://freedesktop.org/wiki/Software/pyxdg/
```

## buildroot-external/package/python-quantulum3/Config.in
```kconfig
config BR2_PACKAGE_PYTHON_QUANTULUM3
	bool "python-quantulum3"
	select BR2_PACKAGE_PYTHON_INFLECT # runtime
	select BR2_PACKAGE_PYTHON_NUM2WORDS # runtime
	help
	  Extract quantities from unstructured text.

	  https://github.com/nielstron/quantulum3
```

## buildroot-external/package/python-quebra-frases/Config.in
```kconfig
config BR2_PACKAGE_PYTHON_QUEBRA_FRASES
	bool "python-quebra-frases"
	help
	  quebra_frases chunks strings into byte sized pieces.

	  https://github.com/OpenJarbas/quebra_frases
```

## buildroot-external/package/python-rakekeywords/Config.in
```kconfig
config BR2_PACKAGE_PYTHON_RAKEKEYWORDS
	bool "python-rakekeywords"
	select BR2_PACKAGE_PYTHON_STOPWORDSISO # runtime
	help
	  Implementation of RAKE - Rapid Automatic Keyword Extraction.

	  https://github.com/OpenJarbas/RAKEkeywords
```

## buildroot-external/package/python-rapidfuzz/Config.in
```kconfig
config BR2_PACKAGE_PYTHON_RAPIDFUZZ
	bool "python-rapidfuzz"
	help
	  RapidFuzz is a fast string matching 
	  library for Python and C++, which is 
	  using the string similarity calculations 
	  from FuzzyWuzzy.

	  https://github.com/maxbachmann/rapidfuzz
```

## buildroot-external/package/python-ratelim/Config.in
```kconfig
config BR2_PACKAGE_PYTHON_RATELIM
	bool "python-ratelim"
	select BR2_PACKAGE_PYTHON_DECORATOR # runtime
	help
	  Makes it easy to respect rate limits.

	  http://github.com/themiurgo/ratelim
```

## buildroot-external/package/python-requests-cache/Config.in
```kconfig
config BR2_PACKAGE_PYTHON_REQUESTS_CACHE
	bool "python-requests-cache"
	select BR2_PACKAGE_PYTHON_REQUESTS # runtime
	help
	  Persistent cache for requests library.

	  https://github.com/reclosedev/requests-cache
```

## buildroot-external/package/python-requests-futures/Config.in
```kconfig
config BR2_PACKAGE_PYTHON_REQUESTS_FUTURES
	bool "python-requests-futures"
	select BR2_PACKAGE_PYTHON_REQUESTS # runtime
	help
	  Asynchronous Python HTTP for Humans.

	  https://github.com/ross/requests-futures
```

## buildroot-external/package/python-reverse-geocoder/Config.in
```kconfig
config BR2_PACKAGE_PYTHON_REVERSE_GEOCODER
	bool "python-reverse-geocoder"
	help
	  Fast, offline reverse geocoder.

	  https://github.com/thampiman/reverse-geocoder
```

## buildroot-external/package/python-rich-click/Config.in
```kconfig
config BR2_PACKAGE_PYTHON_RICH_CLICK
	bool "python-rich-rick"
	help
	  Format click help output nicely with Rich.

	  https://github.com/ewels/rich-click
```

## buildroot-external/package/python-rich/Config.in
```kconfig
config BR2_PACKAGE_PYTHON_RICH
	bool "python-rich"
	help
	  Rich is a Python library for rich text and beautiful 
	  formatting in the terminal.

	  https://github.com/Textualize/rich
```
