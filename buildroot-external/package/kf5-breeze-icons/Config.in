## buildroot-external/package/kf5-kactivities/Config.in
```kconfig
config BR2_PACKAGE_KF5_KACTIVITIES
	bool "kf5-kactivities"
	select BR2_PACKAGE_KF5_KCONFIG
	select BR2_PACKAGE_KF5_KWINDOWSYSTEM
```

## buildroot-external/package/kf5-kbookmarks/Config.in
```kconfig
config BR2_PACKAGE_KF5_KBOOKMARKS
	bool "kf5-kbookmarks"
	select BR2_PACKAGE_KF5_KCODECS
	select BR2_PACKAGE_KF5_KCONFIGWIDGETS
	select BR2_PACKAGE_KF5_KXMLGUI
```

## buildroot-external/package/kf5-kconfigwidgets/Config.in
```kconfig
config BR2_PACKAGE_KF5_KCONFIGWIDGETS
	bool "kf5-kconfigwidgets"
	select BR2_PACKAGE_KF5_KGUIADDONS
	select BR2_PACKAGE_KF5_KI18N
	select BR2_PACKAGE_KF5_KWIDGETSADDONS
```

## buildroot-external/package/kf5-kdeclarative/Config.in
```kconfig
config BR2_PACKAGE_KF5_KDECLARATIVE
	bool "kf5-kdeclarative"
	select BR2_PACKAGE_KF5_KIO
```

## buildroot-external/package/kf5-kdeconnect/Config.in
```kconfig
config BR2_PACKAGE_KF5_KDECONNECT
	bool "kf5-kdeconnect"
	select BR2_PACKAGE_KF5_QCA
	select BR2_PACKAGE_KF5_PULSEAUDIO_QT
```

## buildroot-external/package/kf5-kglobalaccel/Config.in
```kconfig
config BR2_PACKAGE_KF5_KGLOBALACCEL
	bool "kf5-kglobalaccel"
	select BR2_PACKAGE_KF5_KCRASH
	select BR2_PACKAGE_KF5_KDBUSADDONS
```
