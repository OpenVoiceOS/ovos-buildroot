## buildroot-external/package/python-gitdb/Config.in
```kconfig
config BR2_PACKAGE_PYTHON_GITDB
	bool "python-gitdb"
	help
	  GitDB is a pure-Python git object database

	  https://github.com/gitpython-developers/gitdb
```

## buildroot-external/package/python-gitdb2/Config.in
```kconfig
config BR2_PACKAGE_PYTHON_GITDB2
	bool "python-gitdb2"
	select BR2_PACKAGE_PYTHON_SMMAP2 # runtime
	help
	  Git Object Database.

	  https://github.com/gitpython-developers/gitdb
```

## buildroot-external/package/python-gitpython/Config.in
```kconfig
config BR2_PACKAGE_PYTHON_GITPYTHON
	bool "python-gitpython"
	select BR2_PACKAGE_PYTHON_GITDB2 # runtime
	help
	  Python Git Library.

	  https://github.com/gitpython-developers/GitPython
```

## buildroot-external/package/python-google-api-python-client/Config.in
```kconfig
config BR2_PACKAGE_PYTHON_GOOGLE_API_PYTHON_CLIENT
	bool "python-google-api-python-client"
	select BR2_PACKAGE_PYTHON_HTTPLIB2 # runtime
	select BR2_PACKAGE_PYTHON_GOOGLE_AUTH # runtime
	select BR2_PACKAGE_PYTHON_GOOGLE_AUTH_HTTPLIB2 # runtime
	select BR2_PACKAGE_PYTHON_SIX # runtime
	select BR2_PACKAGE_PYTHON_URITEMPLATE # runtime
	help
	  Google API Client Library for Python.

	  http://github.com/google/google-api-python-client/
```

## buildroot-external/package/python-google-auth-httplib2/Config.in
```kconfig
config BR2_PACKAGE_PYTHON_GOOGLE_AUTH_HTTPLIB2
	bool "python-google-auth-httplib2"
	select BR2_PACKAGE_PYTHON_GOOGLE_AUTH # runtime
	select BR2_PACKAGE_PYTHON_HTTPLIB2 # runtime
	help
	  Google Authentication Library: httplib2 transport.

	  https://github.com/GoogleCloudPlatform/google-auth-library-python-httplib2
```

## buildroot-external/package/python-google-auth/Config.in
```kconfig
config BR2_PACKAGE_PYTHON_GOOGLE_AUTH
	bool "python-google-auth"
	select BR2_PACKAGE_PYTHON_PYASN1_MODULES # runtime
	select BR2_PACKAGE_PYTHON_RSA # runtime
	select BR2_PACKAGE_PYTHON_SIX # runtime
	select BR2_PACKAGE_PYTHON_CACHETOOLS # runtime
	help
	  Google Authentication Library.

	  https://github.com/GoogleCloudPlatform/google-auth-library-python
```

## buildroot-external/package/python-google-trans-new/Config.in
```kconfig
config BR2_PACKAGE_PYTHON_GOOGLE_TRANS_NEW
	bool "python-google-trans-new"
	help
	  A free and unlimited python tools for google translate api.

	  https://github.com/lushan88a/google_trans_new
```

## buildroot-external/package/python-gpiod/Config.in
```kconfig
config BR2_PACKAGE_PYTHON_GPIOD
	bool "python-gpiod"
	depends on !BR2_PACKAGE_LIBGPIOD
	help
	  This is a C library that abstracts the GPIO character
	  device operations on linux.

	  https://git.kernel.org/pub/scm/libs/libgpiod/libgpiod.git/

	  This package is the continuation of the libgpiod package
	  for versions 2.0 and above.

	  Note that a kernel of 5.10 or above is required for the
	  ioctls to work.
```

## buildroot-external/package/python-gpiozero/Config.in
```kconfig
config BR2_PACKAGE_PYTHON_GPIOZERO
	bool "python-gpiozero"
	help
	  A simple interface to GPIO devices with Raspberry Pi..

	  https://github.com/RPi-Distro/python-gpiozero
```

## buildroot-external/package/python-gpsdclient/Config.in
```kconfig
config BR2_PACKAGE_PYTHON_GPSDCLIENT
	bool "python-gpsdclient"
	help
	  A simple gpsd client.

	  https://github.com/tfeldmann/gpsdclient
```

## buildroot-external/package/python-gtts/Config.in
```kconfig
config BR2_PACKAGE_PYTHON_GTTS
	bool "python-gtts"
	select BR2_PACKAGE_PYTHON_SIX # runtime
	select BR2_PACKAGE_PYTHON_BS4 # runtime
	select BR2_PACKAGE_PYTHON_CLICK # runtime
	select BR2_PACKAGE_PYTHON_REQUESTS # runtime
	select BR2_PACKAGE_PYTHON_GTTS_TOKEN # runtime
	help
	  gTTS (Google Text-to-Speech), a Python library and CLI tool
	  to interface with Google Translate's text-to-speech API.

	  https://github.com/pndurette/gTTS
```

## buildroot-external/package/python-gtts_token/Config.in
```kconfig
config BR2_PACKAGE_PYTHON_GTTS_TOKEN
	bool "python-gtts_token"
	select BR2_PACKAGE_PYTHON_REQUESTS # runtime
	help
	  Calculates a token to run the Google Translate text to
	  speech.

	  https://github.com/boudewijn26/gTTS-token
```

## buildroot-external/package/python-h3/Config.in
```kconfig
config BR2_PACKAGE_PYTHON_H3
	bool "python-h3"
	help
	  Uber's H3 Hexagonal Hierarchical Geospatial Indexing System in Python

	  https://github.com/uber/h3-py
```

## buildroot-external/package/python-hijri-converter/Config.in
```kconfig
config BR2_PACKAGE_PYTHON_HIJRI_CONVERTER
	bool "python-hijri-converter"
	help
	  Accurate Hijri-Gregorian dates converter based on the Umm
	  al-Qura calendar.

	  https://github.com/mhalshehri/hijri-converter
```

## buildroot-external/package/python-holidays/Config.in
```kconfig
config BR2_PACKAGE_PYTHON_HOLIDAYS
	bool "python-holidays"
	select BR2_PACKAGE_PYTHON_CONVERTDATE # runtime
	select BR2_PACKAGE_PYTHON_DATEUTIL # runtime
	select BR2_PACKAGE_PYTHON_KOREAN_LUNAR_CALENDAR # runtime
	select BR2_PACKAGE_PYTHON_SIX # runtime
	help
	  Generate and work with holidays in Python.

	  https://github.com/dr-prodigy/python-holidays
```

## buildroot-external/package/python-holmesv/Config.in
```kconfig
config BR2_PACKAGE_PYTHON_HOLMESV
	bool "python-holmesv"
	help
	  Mycroft Core, the Mycroft Artificial Intelligence platform.
	  packaged as importable library. 

	  https://mycroft.ai/
```

## buildroot-external/package/python-humanhash3/Config.in
```kconfig
config BR2_PACKAGE_PYTHON_HUMANHASH3
	bool "python-humanhash3"
	help
	  Human-readable representations of digests.

	  https://github.com/blag/humanhash
```

## buildroot-external/package/python-importlib-metadata/Config.in
```kconfig
config BR2_PACKAGE_PYTHON_IMPORTLIB_METADATA
	bool "python-importlib-metadata"
	help
	  Library to access the metadata for a 
	  Python package.

	  This package supplies third-party access 
	  to the functionality of importlib.metadata 
	  including improvements added to subsequent 
	  Python versions.

	  https://github.com/python/importlib_metadata
```

## buildroot-external/package/python-inflect/Config.in
```kconfig
config BR2_PACKAGE_PYTHON_INFLECT
	bool "python-inflect"
	help
	  Correctly generate plurals, ordinals, 
	  indefinite articles; convert numbers to words

	  https://github.com/jaraco/inflect
```

## buildroot-external/package/python-inflection/Config.in
```kconfig
config BR2_PACKAGE_PYTHON_INFLECTION
	bool "python-inflection"
	help
	  A port of Ruby on Rails inflector to Python.

	  http://github.com/jpvanhal/inflection
```

## buildroot-external/package/python-jaraco-collections/Config.in
```kconfig
config BR2_PACKAGE_PYTHON_JARACO_COLLECTIONS
	bool "python-jaraco-collections"
	help
	  Models and classes to supplement the stdlib 
	  ‘collections’ module.

	  https://github.com/jaraco/jaraco.collections
```

## buildroot-external/package/python-jaraco-context/Config.in
```kconfig
config BR2_PACKAGE_PYTHON_JARACO_CONTEXT
	bool "python-jaraco-context"
	help
	  Available as part of the Tidelift Subscription.

	  This project and the maintainers of thousands of 
	  other packages are working with Tidelift to deliver 
	  one enterprise subscription that covers all of the 
	  open source you use.

	  https://github.com/jaraco/jaraco.context
```

## buildroot-external/package/python-jarbas-stt-plugin-chromium/Config.in
```kconfig
config BR2_PACKAGE_PYTHON_JARBAS_STT_PLUGIN_CHROMIUM
	bool "python-jarbas-stt-plugin-chromium"
	select BR2_PACKAGE_PYTHON_REQUESTS # runtime
	help
	  A stt plugin for mycroft using the google chrome browser
	  api.

	  https://github.com/OpenVoiceOS/jarbas-stt-plugin-chromium
```

## buildroot-external/package/python-jarbas-stt-plugin-vosk/Config.in
```kconfig
config BR2_PACKAGE_PYTHON_JARBAS_STT_PLUGIN_VOSK
	bool "python-jarbas-stt-plugin-vosk"
	help
	  Mycroft STT plugin for Vosk

	  https://github.com/JarbasLingua/jarbas-stt-plugin-vosk
```

## buildroot-external/package/python-joblib/Config.in
```kconfig
config BR2_PACKAGE_PYTHON_JOBLIB
	bool "python-joblib"
	help
	  Lightweight pipelining with Python functions.

	  https://joblib.readthedocs.io
```
