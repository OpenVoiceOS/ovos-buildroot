## buildroot-external/package/mycroft-skill-ovos-common-query/Config.in
```kconfig
config BR2_PACKAGE_MYCROFT_SKILL_OVOS_COMMON_QUERY
	bool "mycroft-skill-ovos-common-query"
	help
	  Skill Negotiating for the best source for 
	  an answer via Common QA

	  https://github.com/OpenVoiceOS/skill-ovos-common-query
```

## buildroot-external/package/mycroft-skill-ovos-enclosure/Config.in
```kconfig
config BR2_PACKAGE_MYCROFT_SKILL_OVOS_ENCLOSURE
	bool "mycroft-skill-ovos-enclosure"
	help
	  Mycroft AI - OVOS Enclosure Skill
	  Mycroft skill to take control of OpenVoiceOS 
	  it's functions and tools.

	  https://github.com/OpenVoiceOS/skill-ovos-enclosure
```

## buildroot-external/package/mycroft-skill-ovos-homescreen/Config.in
```kconfig
config BR2_PACKAGE_MYCROFT_SKILL_OVOS_HOMESCREEN
	bool "mycroft-skill-ovos-homescreen"
	help
	  Mycroft AI - OVOS Homescreen Skill
	  Provides custom resting face for OVOS

	  https://github.com/OpenVoiceOS/skill-ovos-homescreen
```

## buildroot-external/package/mycroft-skill-ovos-info/Config.in
```kconfig
config BR2_PACKAGE_MYCROFT_SKILL_OVOS_INFO
	bool "mycroft-skill-ovos-info"
	help
	  Skill information parser support skill

	  https://github.com/OpenVoiceOS/ovos-skills-info
```

## buildroot-external/package/mycroft-skill-ovos-mycroftgui/Config.in
```kconfig
config BR2_PACKAGE_MYCROFT_SKILL_OVOS_MYCROFTGUI
	bool "mycroft-skill-ovos-mycroftgui"
	help
	  Mycroft AI - OVOS MycroftGUI Skill
	  Mycroft skill to take control of the Mycroft 
	  GUI QT application.

	  https://github.com/OpenVoiceOS/skill-ovos-mycroftgui
```

## buildroot-external/package/mycroft-skill-ovos-notes/Config.in
```kconfig
config BR2_PACKAGE_MYCROFT_SKILL_OVOS_NOTES
	bool "mycroft-skill-ovos-notes"
	help
	  Take personal notes to keep track of appointments, 
	  to-do items, etc.

	  https://github.com/OpenVoiceOS/skill-ovos-notes
```

## buildroot-external/package/mycroft-skill-ovos-pairing/Config.in
```kconfig
config BR2_PACKAGE_MYCROFT_SKILL_OVOS_PAIRING
	bool "mycroft-skill-ovos-pairing"
	help
	  Mycroft AI - OVOS Pairing Skill
	  Connect your device to the Mycroft server

	  https://github.com/OpenVoiceOS/skill-ovos-pairing
```

## buildroot-external/package/mycroft-skill-ovos-settings/Config.in
```kconfig
config BR2_PACKAGE_MYCROFT_SKILL_OVOS_SETTINGS
	bool "mycroft-skill-ovos-settings"
	help
	  Skill to take control of OpenVoiceOS functions 
	  via websettings interface

	  https://github.com/OpenVoiceOS/skill-ovos-settings
```

## buildroot-external/package/mycroft-skill-ovos-setup/Config.in
```kconfig
config BR2_PACKAGE_MYCROFT_SKILL_OVOS_SETUP
	bool "mycroft-skill-ovos-setup"
	help
	  OVOS Setup Skill

	  https://github.com/OpenVoiceOS/skill-ovos-setup
```

## buildroot-external/package/mycroft-skill-ovos-stop/Config.in
```kconfig
config BR2_PACKAGE_MYCROFT_SKILL_OVOS_STOP
	bool "mycroft-skill-ovos-stop"
	help
	  Provides verbal interfaces for basic framework 
	  interactions, such as the "Stop" command. 

	  https://github.com/OpenVoiceOS/skill-ovos-stop
```

## buildroot-external/package/mycroft-skill-ovos-timer/Config.in
```kconfig
config BR2_PACKAGE_MYCROFT_SKILL_OVOS_TIMER
	bool "mycroft-skill-ovos-timer"
	help
	  Set named timers for cooking, watering 
	  plants, brewing tea and more.

	  https://github.com/OpenVoiceOS/skill-ovos-timer
```

## buildroot-external/package/mycroft-skill-ovos-volume/Config.in
```kconfig
config BR2_PACKAGE_MYCROFT_SKILL_OVOS_VOLUME
	bool "mycroft-skill-ovos-volume"
	help
	  OVOS Volume Skill
	  Control the volume of your Device

	  https://github.com/OpenVoiceOS/skill-ovos-volume
```

## buildroot-external/package/mycroft-skill-parrot/Config.in
```kconfig
config BR2_PACKAGE_MYCROFT_SKILL_PARROT
	bool "mycroft-skill-parrot"
	help
	  Turn Mycroft into a echoing parrot!

	  https://github.com/JarbasSkills/skill-parrot
```

## buildroot-external/package/mycroft-skill-personal/Config.in
```kconfig
config BR2_PACKAGE_MYCROFT_SKILL_PERSONAL
	bool "mycroft-skill-personal"
	help
	  Learn history and personality of Mycroft

	  https://github.com/MycroftAI/skill-personal
```

## buildroot-external/package/mycroft-skill-query/Config.in
```kconfig
config BR2_PACKAGE_MYCROFT_SKILL_QUERY
	bool "mycroft-skill-query"
	help
	  Skill Negotiating for the best source for 
	  an answer via Common QA

	  https://github.com/MycroftAI/skill-query
```

## buildroot-external/package/mycroft-skill-reminder/Config.in
```kconfig
config BR2_PACKAGE_MYCROFT_SKILL_REMINDER
	bool "mycroft-skill-reminder"
	help
	  Set single and repeating reminders for tasks

	  https://github.com/MycroftAI/skill-reminder
```

## buildroot-external/package/mycroft-skill-simple-youtube/Config.in
```kconfig
config BR2_PACKAGE_MYCROFT_SKILL_SIMPLE_YOUTUBE
	bool "mycroft-skill-simple-youtube"
	help
	  play music from youtube in mycroft

	  https://github.com/JarbasSkills/skill-simple-youtube
```

## buildroot-external/package/mycroft-skill-singing/Config.in
```kconfig
config BR2_PACKAGE_MYCROFT_SKILL_SINGING
	bool "mycroft-skill-singing"
	help
	  Mycroft sings lyrics to some popular songs

	  https://github.com/MycroftAI/skill-singing
```

## buildroot-external/package/mycroft-skill-speak/Config.in
```kconfig
config BR2_PACKAGE_MYCROFT_SKILL_SPEAK
	bool "mycroft-skill-speak"
	help
	  Make Mycroft repeat whatever you want

	  https://github.com/MycroftAI/skill-speak
```

## buildroot-external/package/mycroft-skill-spelling/Config.in
```kconfig
config BR2_PACKAGE_MYCROFT_SKILL_SPELLING
	bool "mycroft-skill-spelling"
	help
	  Let Mycroft help you spell words

	  https://github.com/MycroftAI/skill-spelling
```

## buildroot-external/package/mycroft-skill-timer/Config.in
```kconfig
config BR2_PACKAGE_MYCROFT_SKILL_TIMER
	bool "mycroft-skill-timer"
	help
	  Set named timers for cooking, watering 
	  plants, brewing tea and more.

	  https://github.com/MycroftAI/mycroft-timer
```

## buildroot-external/package/mycroft-skill-unknown/Config.in
```kconfig
config BR2_PACKAGE_MYCROFT_SKILL_UNKNOWN
	bool "mycroft-skill-unknown"
	help
	  Mycroft AI official Unknown Fallback Skill - 
	  used if no Intent is matched to an Utterance

	  https://github.com/MycroftAI/fallback-unknown
```

## buildroot-external/package/mycroft-skill-weather/Config.in
```kconfig
config BR2_PACKAGE_MYCROFT_SKILL_WEATHER
	bool "mycroft-skill-weather"
	help
	  OpenVoiceOS version of Weather Skill, providing 
	  weather conditions and forecasts.

	  https://github.com/OpenVoiceOS/skill-weather
```

## buildroot-external/package/mycroft-skill-wikipedia-for-humans/Config.in
```kconfig
config BR2_PACKAGE_MYCROFT_SKILL_WIKIPEDIA_FOR_HUMANS
	bool "mycroft-skill-wikipedia-for-humans"
	help
	  Query Wikipedia for answers to all your questions. 
	  Get just a summary, or ask for more to get in-depth 
	  information.

	  https://github.com/JarbasSkills/skill-wikipedia-for-humans
```

## buildroot-external/package/mycroft-skill-wolfie/Config.in
```kconfig
config BR2_PACKAGE_MYCROFT_SKILL_WOLFIE
	bool "mycroft-skill-wolfie"
	help
	  Use Wolfram Alpha for general knowledge questions 

	  https://github.com/JarbasSkills/skill-wolfie
```
