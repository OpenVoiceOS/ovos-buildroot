## buildroot-external/package/python-rsa/Config.in
```kconfig
config BR2_PACKAGE_PYTHON_RSA
	bool "python-rsa"
	help
	  A pure-Python RSA implementation.

	  https://stuvel.eu/rsa
```

## buildroot-external/package/python-ruamel-yaml/Config.in
```kconfig
config BR2_PACKAGE_PYTHON_RUAMEL_YAML
	bool "python-ruamel-yaml"
	help
	  ruamel.yaml is a YAML 1.2 loader/dumper package for Python.

	  https://pypi.org/project/ruamel.yaml/
```

## buildroot-external/package/python-scipy/Config.in
```kconfig
config BR2_PACKAGE_PYTHON_SCIPY
	bool "python-scipy"
	depends on BR2_TOOLCHAIN_HAS_FORTRAN
	depends on BR2_PACKAGE_OPENBLAS_ARCH_SUPPORTS # build
	depends on BR2_PACKAGE_PYTHON_NUMPY_ARCH_SUPPORTS # python-numpy
	depends on BR2_TOOLCHAIN_USES_GLIBC || BR2_TOOLCHAIN_USES_MUSL # python-numpy
	select BR2_PACKAGE_OPENBLAS # build
	select BR2_PACKAGE_CLAPACK # build
	select BR2_PACKAGE_PYTHON_NUMPY # runtime
	help
	  Scipy is a Python package that includes modules for
	  statistics, optimization, linear algebra and much
	  more.

	  http://www.scipy.org/

comment "python-scipy needs toolchain with fortran"
	  depends on !BR2_TOOLCHAIN_HAS_FORTRAN

comment "python-scipy needs lib openblas"
	  depends on !BR2_PACKAGE_OPENBLAS_ARCH_SUPPORTS

comment "python-scipy needs python-numpy"
	depends on !BR2_PACKAGE_PYTHON_NUMPY_ARCH_SUPPORTS
```

## buildroot-external/package/python-selene-api/Config.in
```kconfig
config BR2_PACKAGE_PYTHON_SELENE_API
	bool "python-selene-api"
	help
	  Unofficial python api for interaction with 
	  https://api.mycroft.ai , also compatible with 
	  ovos-local-backend 

	  https://github.com/OpenVoiceOS/selene_api
```

## buildroot-external/package/python-sgmllib3k/Config.in
```kconfig
config BR2_PACKAGE_PYTHON_SGMLLIB3K
	bool "python-sgmllib3k"
	help
	  Py3k port of sgmllib.

	  http://hg.hardcoded.net/sgmllib
```

## buildroot-external/package/python-simplematch/Config.in
```kconfig
config BR2_PACKAGE_PYTHON_SIMPLEMATCH
	bool "python-simplematch"
	help
	  Minimal, super readable string pattern matching.

	  https://github.com/tfeldmann/simplematch
```

## buildroot-external/package/python-smmap/Config.in
```kconfig
config BR2_PACKAGE_PYTHON_SMMAP
	bool "python-smmap"
	help
	  A pure Python implementation of a sliding window memory map
	  manager.

	  https://github.com/gitpython-developers/smmap
```

## buildroot-external/package/python-smmap2/Config.in
```kconfig
config BR2_PACKAGE_PYTHON_SMMAP2
	bool "python-smmap2"
	help
	  A pure python implementation of a sliding window memory map
	  manager.

	  https://github.com/gitpython-developers/smmap
```

## buildroot-external/package/python-sonopy/Config.in
```kconfig
config BR2_PACKAGE_PYTHON_SONOPY
	bool "python-sonopy"
	select BR2_PACKAGE_PYTHON_NUMPY # runtime
	select BR2_PACKAGE_PYTHON_SCIPY # runtime
	help
	  A simple audio feature extraction library.

	  https://github.com/mycroftai/sonopy
```

## buildroot-external/package/python-source/Config.in
```kconfig
config BR2_PACKAGE_PYTHON_SOURCE
	bool "python-source"
	help
	  A simple printer of source list.

	  http://www.cctv.com
```

## buildroot-external/package/python-speech2text/Config.in
```kconfig
config BR2_PACKAGE_PYTHON_SPEECH2TEXT
	bool "python-speech2text"
	select BR2_PACKAGE_PYTHON_REQUESTS # runtime
	select BR2_PACKAGE_PYTHON_SPEECHRECOGNITION # runtime
	help
	  Mycroft STT engine wrappers.

	  https://github.com/JarbasAl/speech2text
```

## buildroot-external/package/python-speechrecognition/Config.in
```kconfig
config BR2_PACKAGE_PYTHON_SPEECHRECOGNITION
	bool "python-speechrecognition"
	help
	  Library for performing speech recognition, with 
	  support for several engines and APIs, online and offline.

	  https://github.com/Uberi/speech_recognition
```

## buildroot-external/package/python-sqlalchemy-json/Config.in
```kconfig
config BR2_PACKAGE_PYTHON_SQLALCHEMY_JSON
	bool "python-sqlalchemy-json"
	help
	  SQLAlchemy-JSON provides mutation-tracked JSON types to SQLAlchemy

	  https://github.com/edelooff/sqlalchemy-json
```

## buildroot-external/package/python-srt/Config.in
```kconfig
config BR2_PACKAGE_PYTHON_SRT
	bool "python-srt"
	help
	  A tiny library for parsing, modifying, and composing SRT
	  files.

	  https://github.com/cdown/srt
```

## buildroot-external/package/python-stopwordsiso/Config.in
```kconfig
config BR2_PACKAGE_PYTHON_STOPWORDSISO
	bool "python-stopwordsiso"
	help
	  Collection of stopwords for multiple languages. Using ISO
	  639-1 language code.

	  https://github.com/bact/stopwords-iso
```

## buildroot-external/package/python-tailhead/Config.in
```kconfig
config BR2_PACKAGE_PYTHON_TAILHEAD
	bool "python-tailhead"
	help
	  tailhead is a simple implementation of GNU tail and head.

	  https://github.com/GreatFruitOmsk/tailhead
```

## buildroot-external/package/python-tbm-utils/Config.in
```kconfig
config BR2_PACKAGE_PYTHON_TBM_UTILS
	bool "python-tbm-utils"
	select BR2_PACKAGE_PYTHON_ATTRS # runtime
	select BR2_PACKAGE_PYTHON_PENDULUM # runtime
	select BR2_PACKAGE_PYTHON_PPRINTPP # runtime
	select BR2_PACKAGE_PYTHON_WRAPT # runtime
	help
	  A commonly-used set of utilities used by me (thebigmunch).

	  https://github.com/thebigmunch/tbm-utils
```

## buildroot-external/package/python-tflit/Config.in
```kconfig
config BR2_PACKAGE_PYTHON_TFLIT
	bool "python-tflit"
	help
	  tflite_runtime, but easier.

	  https://github.com/beasteers/tflit
```

## buildroot-external/package/python-timezonefinder/Config.in
```kconfig
config BR2_PACKAGE_PYTHON_TIMEZONEFINDER
	bool "python-timezonefinder"
	help
	  This is a fast and lightweight python 
	  package for looking up the corresponding 
	  timezone for given coordinates on earth 
	  entirely offline.

	  https://github.com/MrMinimal64/timezonefinder
```

## buildroot-external/package/python-tutubo/Config.in
```kconfig
config BR2_PACKAGE_PYTHON_TUTUBO
	bool "python-tutubo"
	select BR2_PACKAGE_PYTHON_BS4 # runtime
	select BR2_PACKAGE_PYTHON_PYTUBE # runtime
	select BR2_PACKAGE_PYTHON_REQUESTS # runtime
	select BR2_PACKAGE_PYTHON_YTMUSICAPI # runtime
	help
	  wrapper around pytube with some new functionality.

	  https://github.com/OpenJarbas/tutubo
```

## buildroot-external/package/python-typing/Config.in
```kconfig
config BR2_PACKAGE_PYTHON_TYPING
	bool "python-typing"
	help
	  Type Hints for Python.

	  https://docs.python.org/3/library/typing.html
```

## buildroot-external/package/python-tzlocal/Config.in
```kconfig
config BR2_PACKAGE_PYTHON_TZLOCAL
	bool "python-tzlocal"
	help
	  This Python module returns a tzinfo object 
	  with the local timezone information

	  https://github.com/regebro/tzlocal
```

## buildroot-external/package/python-ua-parser/Config.in
```kconfig
config BR2_PACKAGE_PYTHON_UA_PARSER
	bool "python-ua-parser"
	help
	  Python port of Browserscope's user agent parser.

	  https://github.com/ua-parser/uap-python
```

## buildroot-external/package/python-unidecode/Config.in
```kconfig
config BR2_PACKAGE_PYTHON_UNIDECODE
	bool "python-unidecode"
	help
	  ASCII transliterations of Unicode text.

	  
```

## buildroot-external/package/python-uritemplate/Config.in
```kconfig
config BR2_PACKAGE_PYTHON_URITEMPLATE
	bool "python-uritemplate"
	help
	  URI templates.

	  https://uritemplate.readthedocs.org
```
