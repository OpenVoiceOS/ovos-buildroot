## buildroot-external/package/python-neon-solvers/Config.in
```kconfig
config BR2_PACKAGE_PYTHON_NEON_SOLVERS
	bool "python-neon-solvers"
	help
	  neon solvers package 

	  https://github.com/NeonGeckoCom/neon_solvers
```

## buildroot-external/package/python-neon-transformers/Config.in
```kconfig
config BR2_PACKAGE_PYTHON_NEON_TRANSFORMERS
	bool "python-neon-transformers"
	help
	  neon Utterance Transformers

	  https://github.com/NeonGeckoCom/neon-transformers
```

## buildroot-external/package/python-neon-tts-plugin-larynx_server/Config.in
```kconfig
config BR2_PACKAGE_PYTHON_NEON_TTS_PLUGIN_LARYNX_SERVER
	bool "python-neon-tts-plugin-larynx_server"
	help
	  TTS plugin for Larynx

	  https://github.com/NeonGeckoCom/neon-tts-plugin-larynx_server
```

## buildroot-external/package/python-neon-utterance-plugin-rake/Config.in
```kconfig
config BR2_PACKAGE_PYTHON_NEON_UTTERANCE_PLUGIN_RAKE
	bool "python-neon-utterance-plugin-rake"
	help
	  neon utterance rake plugin

	  https://github.com/NeonGeckoCom/neon-utterance-plugin-RAKE
```

## buildroot-external/package/python-nested-lookup/Config.in
```kconfig
config BR2_PACKAGE_PYTHON_NESTED_LOOKUP
	bool "python-nested-lookup"
	select BR2_PACKAGE_PYTHON_SIX # runtime
	help
	  Python functions for working with deeply nested documents
	  (lists and dicts).

	  https://git.unturf.com/python/nested-lookup
```

## buildroot-external/package/python-nltk/Config.in
```kconfig
config BR2_PACKAGE_PYTHON_NLTK
	bool "python-nltk"
	select BR2_PACKAGE_PYTHON_CLICK # runtime
	select BR2_PACKAGE_PYTHON_JOBLIB # runtime
	select BR2_PACKAGE_PYTHON_REGEX # runtime
	select BR2_PACKAGE_PYTHON_TQDM # runtime
	help
	  Natural Language Toolkit.

	  https://www.nltk.org/
```

## buildroot-external/package/python-num2words/Config.in
```kconfig
config BR2_PACKAGE_PYTHON_NUM2WORDS
	bool "python-num2words"
	select BR2_PACKAGE_PYTHON_DOCOPT # runtime
	help
	  Modules to convert numbers to words. Easily extensible.

	  https://github.com/savoirfairelinux/num2words
```

## buildroot-external/package/python-olefile/Config.in
```kconfig
config BR2_PACKAGE_PYTHON_OLEFILE
	bool "python-olefile"
	help
	  Python package to parse, read and write Microsoft OLE2
	  files (Structured Storage or Compound Document, Microsoft
	  Office).

	  https://www.decalage.info/python/olefileio
```

## buildroot-external/package/python-ovos-audio-plugin-simple/Config.in
```kconfig
config BR2_PACKAGE_PYTHON_OVOS_AUDIO_PLUGIN_SIMPLE
	bool "python-ovos-audio-plugin-simple"
	select BR2_PACKAGE_PYTHON_OVOS_PLUGIN_MANAGER # runtime
	help
	  simple audio plugin for ovos.

	  https://github.com/OpenVoiceOS/ovos-audio-plugin-simple
```

## buildroot-external/package/python-ovos-audio/Config.in
```kconfig
config BR2_PACKAGE_PYTHON_OVOS_AUDIO
	bool "python-ovos-audio"
	help
	  The "mouth" of the OVOS assistant!

	  Handles TTS generation and audio playback 

	  https://github.com/OpenVoiceOS/ovos-audio
```

## buildroot-external/package/python-ovos-backend-client/Config.in
```kconfig
config BR2_PACKAGE_PYTHON_OVOS_BACKEND_CLIENT
	bool "python-ovos-backend-client"
	select BR2_PACKAGE_PYTHON_OVOS_UTILS
	select BR2_PACKAGE_PYTHON_OVOS_CONFIG
	select BR2_PACKAGE_PYTHON_JSON_DATABASE
	select BR2_PACKAGE_PYTHON_OAUTHLIB
	help
	  Unofficial python api for interaction with 
	  https://api.mycroft.ai , also compatible with 
	  ovos-local-backend 

	  https://github.com/OpenVoiceOS/ovos-backend-client
```

## buildroot-external/package/python-ovos-backend-manager/Config.in
```kconfig
config BR2_PACKAGE_PYTHON_OVOS_BACKEND_MANAGER
	bool "python-ovos-backend-manager"
	help
	  A simple web UI for personal backend, powered by PyWebIO

	  https://github.com/OpenVoiceOS/ovos-backend-manager
```

## buildroot-external/package/python-ovos-bus-client/Config.in
```kconfig
config BR2_PACKAGE_PYTHON_OVOS_BUS_CLIENT
	bool "python-ovos-bus-client"
	help
	  This module is a simple interface for the mycroft 
	  messagebus and can be used to connect to ovos, send 
	  messages and react to messages sent by the OpenVoiceOS 
	  system.

	  This module extends the mycroft-messagebus-client with 
	  a Session implementation

	  https://github.com/OpenVoiceOS/ovos-bus-client
```

## buildroot-external/package/python-ovos-classifiers/Config.in
```kconfig
config BR2_PACKAGE_PYTHON_OVOS_CLASSIFIERS
	bool "python-ovos-classifiers"
	help
	  provide baseline feature extraction pipelines suited for each task

	  provide user facing classes for each NLP task needed in the OVOS ecosystem
		transparently load different models (model_path or external plugin)

	  provide dataset loaders suited for each of those tasks per language

	  provide baseline heuristic implementation for each task per language
		replaces ovos-lingua-franca

	  provide baseline implementations and benchmarks using classical nltk and 
	  scikit-learn algorithms
		minimum viable implementation to ensure lang support 

	  https://github.com/OpenVoiceOS/ovos-core
```

## buildroot-external/package/python-ovos-cli-client/Config.in
```kconfig
config BR2_PACKAGE_PYTHON_OVOS_CLI_CLIENT
	bool "python-ovos-cli-client"
	help
	  mycroft-core cli client extracted into a standalone component

	  https://github.com/OpenVoiceOS/ovos_cli_client
```

## buildroot-external/package/python-ovos-config-assistant/Config.in
```kconfig
config BR2_PACKAGE_PYTHON_OVOS_CONFIG_ASSISTANT
	bool "python-ovos-config-assistant"
	help
	  ovos config assistant library

	  https://github.com/OpenVoiceOS/ovos-config-assistant
```

## buildroot-external/package/python-ovos-config/Config.in
```kconfig
config BR2_PACKAGE_PYTHON_OVOS_CONFIG
	bool "python-ovos-config"
	help
	  helper package to interact with mycroft config 

	  https://github.com/OpenVoiceOS/ovos-config
```

## buildroot-external/package/python-ovos-core/Config.in
```kconfig
config BR2_PACKAGE_PYTHON_OVOS_CORE
	bool "python-ovos-core"
	help
	  OVOS-core is a backwards-compatible descendant of 
	  Mycroft-core, the central component of Mycroft 

	  https://github.com/OpenVoiceOS/ovos-core
```

## buildroot-external/package/python-ovos-gui-plugin-shell-companion/Config.in
```kconfig
config BR2_PACKAGE_PYTHON_OVOS_GUI_PLUGIN_SHELL_COMPANION
	bool "python-ovos-gui-plugin-shell-companion"
	select BR2_PACKAGE_PYTHON_OVOS_PLUGIN_MANAGER
	select BR2_PACKAGE_PYTHON_OVOS_UTILS
	select BR2_PACKAGE_PYTHON_OVOS_CONFIG
	select BR2_PACKAGE_PYTHON_ASTRAL
	help
	  provides various bus APIs that integrate with 
	  ovos-shell.
	    - color scheme manager
	    - notifications widgets
	    - configuration provider  (settings UI)
	    - brightness control  (night mode etc) 

	  https://github.com/OpenVoiceOS/ovos-gui-plugin-shell-companion
```

## buildroot-external/package/python-ovos-gui/Config.in
```kconfig
config BR2_PACKAGE_PYTHON_OVOS_GUI
	bool "python-ovos-gui"
	select BR2_PACKAGE_PYTHON_OVOS_BUS_CLIENT
	select BR2_PACKAGE_PYTHON_OVOS_UTILS
	select BR2_PACKAGE_PYTHON_OVOS_CONFIG
	select BR2_PACKAGE_PYTHON_TORNADO
	select BR2_PACKAGE_PYTHON_OVOS_PLUGIN_MANAGER
	help
	  GUI messagebus service, manages GUI state 
	  and implements the gui protocol 

	  https://github.com/OpenVoiceOS/ovos-gui
```

## buildroot-external/package/python-ovos-guiplayer-plugin/Config.in
```kconfig
config BR2_PACKAGE_PYTHON_OVOS_GUIPLAYER_PLUGIN
	bool "python-ovos-guiplayer-plugin"
	help
	  OVOS GUI mediaplayer plugin

	  https://github.com/OpenVoiceOS/ovos-guiplayer-plugin
```

## buildroot-external/package/python-ovos-lingua-franca/Config.in
```kconfig
config BR2_PACKAGE_PYTHON_OVOS_LINGUA_FRANCA
	bool "python-ovos-lingua-franca"
	select BR2_PACKAGE_PYTHON_DATEUTIL # runtime
	help
	  OpenVoiceOS's multilingual text parsing and formatting library.
	  This project has been forked from mycroft-core, it replaces it!

	  https://github.com/OpenVoiceOS/ovos-lingua-franca
```

## buildroot-external/package/python-ovos-listener/Config.in
```kconfig
config BR2_PACKAGE_PYTHON_OVOS_LISTENER
	bool "python-ovos-listener"
	help
	  The "ears" of the OVOS assistant!

	  Listens for wakewords, performs VAD and STT, the 
	  final transcribed speech is then sent to ovos-core 

	  https://github.com/OpenVoiceOS/ovos-listener
```

## buildroot-external/package/python-ovos-messagebus/Config.in
```kconfig
config BR2_PACKAGE_PYTHON_OVOS_MESSAGEBUS
	bool "python-ovos-messagebus"
	help
	  messagebus service, the nervous system of OpenVoiceOS 

	  https://github.com/OpenVoiceOS/ovos-messagebus
```

## buildroot-external/package/python-ovos-notifications-service/Config.in
```kconfig
config BR2_PACKAGE_PYTHON_OVOS_NOTIFICATIONS_SERVICE
	bool "python-ovos-notifications-service"
	help
	  Notifications API Daemon Service 

	  https://github.com/OpenVoiceOS/ovos_notifications_service
```
