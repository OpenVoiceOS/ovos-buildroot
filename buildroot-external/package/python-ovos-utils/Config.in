## buildroot-external/package/python-ovos-utils/Config.in
```kconfig
config BR2_PACKAGE_PYTHON_OVOS_UTILS
	bool "python-ovos-utils"
	help
	  collection of simple utilities for use 
	  across the mycroft ecosystem

	  https://github.com/OpenVoiceOS/ovos_utils
```

## buildroot-external/package/python-ovos-vad-plugin-webrtcvad/Config.in
```kconfig
config BR2_PACKAGE_PYTHON_OVOS_VAD_PLUGIN_WEBRTCVAD
	bool "python-ovos-vad-plugin-webrtcvad"
	help
	  ovos plugin for voice activity detection using webrtcvad

	  https://github.com/OpenVoiceOS/ovos-vad-plugin-webrtcvad
```

## buildroot-external/package/python-ovos-vlc-plugin/Config.in
```kconfig
config BR2_PACKAGE_PYTHON_OVOS_VLC_PLUGIN
	bool "python-ovos-vlc-plugin"
	help
	  OVOS VLC mediaplayer plugin

	  https://github.com/OpenVoiceOS/ovos-vlc-plugin
```

## buildroot-external/package/python-ovos-wake-word-plugin-precise/Config.in
```kconfig
config BR2_PACKAGE_PYTHON_OVOS_WAKE_WORD_PLUGIN_PRECISE
	bool "python-ovos-wake-word-plugin-precise"
	help
	  This adds a plugin for precise, this is the 
	  official mycroft wake word engine and is supported 
	  out of the box by core

	  https://github.com/OpenVoiceOS/ovos-wake-word-plugin-precise
```

## buildroot-external/package/python-ovos-workshop/Config.in
```kconfig
config BR2_PACKAGE_PYTHON_OVOS_WORKSHOP
	bool "python-ovos-workshop"
	help
	  frameworks, templates and patches for the 
	  mycroft universe

	  https://github.com/OpenVoiceOS/OVOS-workshop
```

## buildroot-external/package/python-ovos-ww-plugin-pocketsphinx/Config.in
```kconfig
config BR2_PACKAGE_PYTHON_OVOS_WW_PLUGIN_POCKETSPHINX
	bool "python-ovos-ww-plugin-pocketsphinx"
	help
	  This adds a plugin for pocketsphinx, this is the 
	  fallback mycroft wake word engine and is supported 
	  out of the box by core.

	  https://github.com/OpenVoiceOS/ovos-ww-plugin-pocketsphinx
```

## buildroot-external/package/python-ovos-ww-plugin-precise-lite/Config.in
```kconfig
config BR2_PACKAGE_PYTHON_OVOS_WW_PLUGIN_PRECISE_LITE
	bool "python-ovos-ww-plugin-precise-lite"
	help
	  This adds a plugin for precise-lite

	  https://github.com/OpenVoiceOS/ovos-ww-plugin-precise-lite
```

## buildroot-external/package/python-ovos-ww-plugin-precise/Config.in
```kconfig
config BR2_PACKAGE_PYTHON_OVOS_WW_PLUGIN_PRECISE
	bool "python-ovos-ww-plugin-precise"
	help
	  This adds a plugin for precise, this is the 
	  official mycroft wake word engine and is supported 
	  out of the box by core

	  https://github.com/OpenVoiceOS/ovos-ww-plugin-precise
```

## buildroot-external/package/python-ovos-ww-plugin-vosk/Config.in
```kconfig
config BR2_PACKAGE_PYTHON_OVOS_WW_PLUGIN_VOSK
	bool "python-ovos-ww-plugin-vosk"
	help
	  wake word plugin for Vosk

	  https://github.com/OpenVoiceOS/ovos-ww-plugin-vosk
```

## buildroot-external/package/python-padacioso/Config.in
```kconfig
config BR2_PACKAGE_PYTHON_PADACIOSO
	bool "python-padacioso"
	select BR2_PACKAGE_PYTHON_SIMPLEMATCH # runtime
	help
	  dead simple intent parser.

	  https://github.com/OpenJarbas/padacioso
```

## buildroot-external/package/python-padaos/Config.in
```kconfig
config BR2_PACKAGE_PYTHON_PADAOS
	bool "python-padaos"
	help
	  A rigid, lightweight, dead-simple intent parser.

	  http://github.com/MatthewScholefield/padaos
```

## buildroot-external/package/python-padatious/Config.in
```kconfig
config BR2_PACKAGE_PYTHON_PADATIOUS
	bool "python-padatious"
	select BR2_PACKAGE_PYTHON_FANN2 # runtime
	select BR2_PACKAGE_PYTHON_XXHASH # runtime
	select BR2_PACKAGE_PYTHON_PADAOS # runtime
	help
	  A neural network intent parser.

	  http://github.com/MycroftAI/padatious
```

## buildroot-external/package/python-pafy/Config.in
```kconfig
config BR2_PACKAGE_PYTHON_PAFY
	bool "python-pafy"
	help
	  Python library to download YouTube 
	  content and retrieve metadata

	  https://pypi.org/project/pafy/
```

## buildroot-external/package/python-pako/Config.in
```kconfig
config BR2_PACKAGE_PYTHON_PAKO
	bool "python-pako"
	select BR2_PACKAGE_PYTHON_APPDIRS # runtime
	help
	  The universal package manager library.

	  https://github.com/MycroftAI/pako
```

## buildroot-external/package/python-pendulum/Config.in
```kconfig
config BR2_PACKAGE_PYTHON_PENDULUM
	bool "python-pendulum"
	help
	  Python datetimes made easy.

	  https://pypi.org/project/pendulum/
```

## buildroot-external/package/python-pep8/Config.in
```kconfig
config BR2_PACKAGE_PYTHON_PEP8
	bool "python-pep8"
	help
	  Python style guide checker.

	  http://pep8.readthedocs.org/
```

## buildroot-external/package/python-petact/Config.in
```kconfig
config BR2_PACKAGE_PYTHON_PETACT
	bool "python-petact"
	help
	  A package extraction tool.

	  https://github.com/matthewscholefield/petact
```

## buildroot-external/package/python-phoneme-guesser/Config.in
```kconfig
config BR2_PACKAGE_PYTHON_PHONEME_GUESSER
	bool "python-phoneme-guesser"
	select BR2_PACKAGE_PYTHON_UNIDECODE # runtime
	help
	  phonemes from text.

	  https://github.com/OpenJarbas/phoneme_guesser
```

## buildroot-external/package/python-pocketsphinx/Config.in
```kconfig
config BR2_PACKAGE_PYTHON_POCKETSPHINX
	bool "python-pocketsphinx"
	help
	  Python interface to CMU Sphinxbase and Pocketsphinx
	  libraries.

	  https://github.com/bambocher/pocketsphinx-python
```

## buildroot-external/package/python-pprintpp/Config.in
```kconfig
config BR2_PACKAGE_PYTHON_PPRINTPP
	bool "python-pprintpp"
	help
	  pprint++: a drop-in replacement for 
	  pprint that's actually pretty.

	  https://github.com/wolever/pprintpp
```

## buildroot-external/package/python-precise-lite-runner/Config.in
```kconfig
config BR2_PACKAGE_PYTHON_PRECISE_LITE_RUNNER
	bool "python-precise-lite-runner"
	help
	  Precise-runner utilizing tflite-runtime

	  https://github.com/OpenVoiceOS/precise_lite_runner
```

## buildroot-external/package/python-precise-runner/Config.in
```kconfig
config BR2_PACKAGE_PYTHON_PRECISE_RUNNER
	bool "python-precise-runner"
	select BR2_PACKAGE_PYTHON_PYAUDIO # runtime
	help
	  Wrapper to use Mycroft Precise Wake Word Listener.

	  http://github.com/MycroftAI/mycroft-precise
```

## buildroot-external/package/python-premailer/Config.in
```kconfig
config BR2_PACKAGE_PYTHON_PREMAILER
	bool "python-premailer"
	select BR2_PACKAGE_PYTHON_CACHETOOLS # runtime
	select BR2_PACKAGE_PYTHON_CSSSELECT # runtime
	select BR2_PACKAGE_PYTHON_CSSUTILS # runtime
	select BR2_PACKAGE_PYTHON_LXML # runtime
	select BR2_PACKAGE_PYTHON_REQUESTS # runtime
	help
	  Turns CSS blocks into style attributes.

	  http://github.com/peterbe/premailer
```

## buildroot-external/package/python-pulsectl/Config.in
```kconfig
config BR2_PACKAGE_PYTHON_PULSECTL
	bool "python-pulsectl"
	select BR2_PACKAGE_PYTHON_SETUPTOOLS # runtime
	help
	  Python high-level interface and ctypes-based bindings for
	  PulseAudio (libpulse).

	  http://github.com/mk-fg/python-pulse-control
```

## buildroot-external/package/python-pyaudio/Config.in
```kconfig
config BR2_PACKAGE_PYTHON_PYAUDIO
	bool "python-pyaudio"
	help
	  Bindings for PortAudio v19, the cross-platform audio
	  input/output stream library.

	  http://people.csail.mit.edu/hubert/pyaudio/
```
