## buildroot-external/package/spotifyd/Config.in
```kconfig
config BR2_PACKAGE_SPOTIFYD
	bool "spotifyd"
	depends on BR2_PACKAGE_HOST_RUSTC_TARGET_ARCH_SUPPORTS
	select BR2_PACKAGE_HOST_CARGO
        help
	  An open source Spotify client running as a UNIX daemon.
```

## buildroot-external/package/sysbench/Config.in
```kconfig
config BR2_PACKAGE_SYSBENCH_ARCH_SUPPORTS
	bool
	default y if !BR2_powerpc

config BR2_PACKAGE_SYSBENCH
	bool "sysbench"
	depends on BR2_PACKAGE_SYSBENCH_ARCH_SUPPORTS
	depends on BR2_PACKAGE_CK_ARCH_SUPPORTS
	depends on !BR2_STATIC_LIBS # luajit
	depends on !BR2_PACKAGE_LUA # luajit
	depends on BR2_PACKAGE_LUAJIT_ARCH_SUPPORTS # luajit
	depends on BR2_TOOLCHAIN_HAS_THREADS

	select BR2_PACKAGE_LUAJIT
	select BR2_PACKAGE_CK
	select BR2_PACKAGE_PKGCONF
	select BR2_PACKAGE_LIBTOOL
	help
	  This benchmark was designed for identifying basic system
	  parameters, as they are important for system using MySQL (w
	  Innodb) under intensive load. Handling of IO in case of many
	  parallel requests, checked as well as memory allocation
	  /transfer speed and scheduler performance. CPU is benchmarked
	  by using 64bit integer manipulation using Euklid algorithms
	  for prime number computation. Benchmarks are designed to show
	  benefit of multiple CPUs as well as of multiple hard drives,
	  battery backed up write cache.

	  https://github.com/akopytov/sysbench.git
```

## buildroot-external/package/tensorflow-lite/Config.in
```kconfig
config BR2_PACKAGE_TENSORFLOW_LITE
        bool "tensorflow-lite"
        depends on BR2_TOOLCHAIN_GCC_AT_LEAST_9
        depends on BR2_TOOLCHAIN_USES_GLIBC
        depends on BR2_INSTALL_LIBSTDCPP
        depends on BR2_TOOLCHAIN_HAS_THREADS
        depends on BR2_SHARED_LIBS
        depends on ( BR2_arm && BR2_ARM_CPU_ARMV7A ) || ( BR2_aarch64 && BR2_ARM_CPU_ARMV8A )
        select BR2_PACKAGE_CPUINFO
        select BR2_PACKAGE_EIGEN
        select BR2_PACKAGE_FARMHASH
        select BR2_PACKAGE_FFT2D
        select BR2_PACKAGE_FLATBUFFERS
        select BR2_PACKAGE_GEMMLOWP
        select BR2_PACKAGE_LIBABSEIL_CPP
        select BR2_PACKAGE_NEON2SSE
        select BR2_PACKAGE_RUY
	select BR2_PACKAGE_XNNPACK
	select BR2_PACKAGE_OPENCL_HEADERS
	select BR2_PACKAGE_VULKAN_HEADERS
        help
          Tensorflow Lite dynamic library and headers: Inference engine to run previously trained machine learning models.

comment "tensorflow-lite needs needs a toolchain w/ gcc >= 9"
        depends on !BR2_TOOLCHAIN_GCC_AT_LEAST_9

comment "tensorflow-lite needs a toolchain w/ glibc, C++, threads"
        depends on !BR2_TOOLCHAIN_USES_GLIBC || !BR2_INSTALL_LIBSTDCPP || \
                        !BR2_TOOLCHAIN_HAS_THREADS

comment "tensorflow-lite needs a toolchain w/ shared libraries"
        depends on !BR2_SHARED_LIBS

comment "tensorflow-lite in buildroot currently only supports arm + armv7a cpu or arm64 + armv8a cpu targets"
        depends on ( BR2_arm && !BR2_ARM_CPU_ARMV7A ) || ( BR2_aarch64 && !BR2_ARM_CPU_ARMV8A) || (!BR2_arm && !BR2_aarch64)
```

## buildroot-external/package/userland-tools/Config.in
```kconfig
config BR2_PACKAGE_USERLAND_TOOLS
	bool "userland-tools"
	depends on BR2_TOOLCHAIN_HAS_THREADS
	depends on !BR2_STATIC_LIBS
	help
	  Raspberry Pi Userland contains the necessary library to use
	  the VideoCore driver.

	  Includes source for the ARM side code to interface to: EGL,
	  mmal, GLESv2, vcos, openmaxil, vchiq_arm, bcm_host, WFC,
	  OpenVG.

	  https://github.com/raspberrypi/userland/
```

## buildroot-external/package/virtual-touch/Config.in
```kconfig
config BR2_PACKAGE_VIRTUAL_TOUCH
	bool "virtual-touch"
	help
	  Simple virtual input device for 
	  testing things in Linux. Creates 
	  a character device and an input 
	  device.

	  https://github.com/vi/virtual_touchscreen
```

## buildroot-external/package/vnc-eglfs/Config.in
```kconfig
config BR2_PACKAGE_VNC_EGLFS
	bool "vnc-eglfs"
	help
	  VNC server for Qt/Quick on EGLFS

	  https://github.com/uwerat/vnc-eglfs
```

## buildroot-external/package/vocalfusion/Config.in
```kconfig
config BR2_PACKAGE_VOCALFUSION
	bool "vocalfusion"
	help
	  XMOS VocalFusion Raspberry Pi
	  drivers to support the sj201 
	  daughterboard used in the Mark2.

	  https://github.com/OpenVoiceOS/VocalFusionDriver
```

## buildroot-external/package/vosk-api/Config.in
```kconfig
config BR2_PACKAGE_VOSK_API
	bool "vosk-api"
	select BR2_PACKAGE_KALDI
	help
	  Offline speech recognition API for Android, iOS, 
	  Raspberry Pi and servers with Python, Java, C# 
	  and Node

	  https://github.com/alphacep/vosk-api.git
```

## buildroot-external/package/whisper-tflite/Config.in
```kconfig
config BR2_PACKAGE_WHISPER_TFLITE
	bool "whisper-tflite"
	help
	  TensorFlow Lite C++ to run inference on 
	  whisper.tflite(~40 MB hybrid model weights 
	  are in int8 and activations are in float32)

	  https://github.com/usefulsensors/openai-whisper
```

## buildroot-external/package/whispercpp/Config.in
```kconfig
config BR2_PACKAGE_WHISPERCPP
	bool "whispercpp"
	select BR2_PACKAGE_OPENBLAS
	help
	  High-performance inference of OpenAI's Whisper 
	  automatic speech recognition (ASR) model

	  https://github.com/ggerganov/whisper.cpp
```

## buildroot-external/package/wifi-ap/Config.in
```kconfig
config BR2_PACKAGE_WIFI_AP
	bool "wifi-ap"
	help
	  Start a wifi AP when there is no wifi
	  configuration present.

	  https://www.j1nx.nl
```

## buildroot-external/package/wifi-connect/Config.in
```kconfig
config BR2_PACKAGE_WIFI_CONNECT
	bool "wifi-connect"
	depends on BR2_PACKAGE_HOST_RUSTC_TARGET_ARCH_SUPPORTS
	select BR2_PACKAGE_HOST_CARGO
        help
	  WiFi Connect is a utility for dynamically setting the 
	  WiFi configuration on a Linux device via a captive portal. 
	  WiFi credentials are specified by connecting with a 
	  mobile phone or laptop to the access point that WiFi 
	  Connect creates..
```

## buildroot-external/package/wifisetup-service/Config.in
```kconfig
config BR2_PACKAGE_WIFISETUP_SERVICE
	bool "wifisetup-service"
	help
	  A systemd service to start the MycroftOS-WiFiSetup.
```

## buildroot-external/package/wiringpi2/Config.in
```kconfig
config BR2_PACKAGE_WIRINGPI2
	bool "wiringpi2"
	depends on !BR2_STATIC_LIBS
	depends on BR2_USE_MMU # fork()
	depends on BR2_TOOLCHAIN_HAS_THREADS
	help
	  wiringPi libraries (and gpio command)

	  https://github.com/WiringPi/WiringPi

comment "wiringpi2 needs a toolchain w/ threads, dynamic library"
	depends on BR2_USE_MMU
	depends on BR2_STATIC_LIBS || !BR2_TOOLCHAIN_HAS_THREADS
```

## buildroot-external/package/xnnpack/Config.in
```kconfig
config BR2_PACKAGE_XNNPACK
	bool "xnnpack"
	select BR2_PACKAGE_CLOG
	select BR2_PACKAGE_CPUINFO
	select BR2_PACKAGE_PTHREADPOOL
	select BR2_PACKAGE_FP16
	help
	  High-efficiency floating-point neural network 
	  inference operators for mobile, server, and Web

	  https://github.com/google/XNNPACK
```

## buildroot-external/package/xorgproto-mesafix/Config.in
```kconfig
config BR2_PACKAGE_XORGPROTO_MESAFIX
	bool "xorgproto-mesafix"
	help
	  This package combines the protocol headers, which were
	  formerly scattered in individual packages.
```

## buildroot-external/package/xvf3510/Config.in
```kconfig
config BR2_PACKAGE_XVF3510
	bool "xvf3510"
	help
	  xCORE VocalFusion Raspberry Pi
	  drivers and tools to support the
	  sj201 daughterboard used in the 
	  Mark2.

	  https://github.com/xmos/vocalfusion-rpi-setup/
```
